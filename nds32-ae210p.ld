/* This file is generated by nds_ldsag (version (2017-01-11) ). */
ENTRY(_start)
SECTIONS
{
	PROVIDE (__executable_start = 0x000000);
	NDS_SAG_LMA_EILM = 0x000000 ;
	EILM_BEGIN = NDS_SAG_LMA_EILM;
	. = 0x000000;
	".nds32_init_*flash_boot.o" 	: { KEEP(*flash_boot.o(.nds32_init )) }
	".interp_*flash_boot.o" 	: { KEEP(*flash_boot.o(.interp )) }
	".hash_*flash_boot.o" 	: { KEEP(*flash_boot.o(.hash )) }
	".dynsym_*flash_boot.o" 	: { KEEP(*flash_boot.o(.dynsym )) }
	".dynstr_*flash_boot.o" 	: { KEEP(*flash_boot.o(.dynstr )) }
	".gnu.version_*flash_boot.o" 	: { KEEP(*flash_boot.o(.gnu.version )) }
	".gnu.version_d_*flash_boot.o" 	: { KEEP(*flash_boot.o(.gnu.version_d )) }
	".gnu.version_r_*flash_boot.o" 	: { KEEP(*flash_boot.o(.gnu.version_r )) }
	".rel.init_*flash_boot.o" 	: { KEEP(*flash_boot.o(.rel.init )) }
	".rela.init_*flash_boot.o" 	: { KEEP(*flash_boot.o(.rela.init )) }
	".rel.text_*flash_boot.o" 	: { KEEP(*flash_boot.o(.rel.text .rel.text.* .rel.gnu.linkonce.t.* )) }
	".rela.text_*flash_boot.o" 	: { KEEP(*flash_boot.o(.rela.text .rela.text.* .rela.gnu.linkonce.t.* )) }
	".rel.fini_*flash_boot.o" 	: { KEEP(*flash_boot.o(.rel.fini )) }
	".rela.fini_*flash_boot.o" 	: { KEEP(*flash_boot.o(.rela.fini )) }
	".rel.rodata_*flash_boot.o" 	: { KEEP(*flash_boot.o(.rel.rodata .rel.rodata.* .rel.gnu.linkonce.r.* )) }
	".rela.rodata_*flash_boot.o" 	: { KEEP(*flash_boot.o(.rela.rodata .rela.rodata.* .rela.gnu.linkonce.r.* )) }
	".rel.data.rel.ro_*flash_boot.o" 	: { KEEP(*flash_boot.o(.rel.data.rel.ro* )) }
	".rela.data.rel.ro_*flash_boot.o" 	: { KEEP(*flash_boot.o(.rel.data.rel.ro* )) }
	".rel.data_*flash_boot.o" 	: { KEEP(*flash_boot.o(.rel.data .rel.data.* .rel.gnu.linkonce.d.* )) }
	".rela.data_*flash_boot.o" 	: { KEEP(*flash_boot.o(.rela.data .rela.data.* .rela.gnu.linkonce.d.* )) }
	".rel.tdata_*flash_boot.o" 	: { KEEP(*flash_boot.o(.rel.tdata .rel.tdata.* .rel.gnu.linkonce.td.* )) }
	".rela.tdata_*flash_boot.o" 	: { KEEP(*flash_boot.o(.rela.tdata .rela.tdata.* .rela.gnu.linkonce.td.* )) }
	".rel.tbss_*flash_boot.o" 	: { KEEP(*flash_boot.o(.rel.tbss .rel.tbss.* .rel.gnu.linkonce.tb.* )) }
	".rela.tbss_*flash_boot.o" 	: { KEEP(*flash_boot.o(.rela.tbss .rela.tbss.* .rela.gnu.linkonce.tb.* )) }
	".rel.ctors_*flash_boot.o" 	: { KEEP(*flash_boot.o(.rel.ctors )) }
	".rela.ctors_*flash_boot.o" 	: { KEEP(*flash_boot.o(.rela.ctors )) }
	".rel.dtors_*flash_boot.o" 	: { KEEP(*flash_boot.o(.rel.dtors )) }
	".rela.dtors_*flash_boot.o" 	: { KEEP(*flash_boot.o(.rela.dtors )) }
	".rela.dyn_*flash_boot.o" 	: { KEEP(*flash_boot.o(rela.dyn )) KEEP(*flash_boot.o(.rela__libc_subfreeres )) KEEP(*flash_boot.o(.rela__libc_atexit )) KEEP(*flash_boot.o(.rela__libc_thread_subfreeres )) KEEP(*flash_boot.o(.rela.init_array )) KEEP(*flash_boot.o(.rela.fini_array )) }
	".rel.got_*flash_boot.o" 	: { KEEP(*flash_boot.o(.rel.got )) }
	".rela.got_*flash_boot.o" 	: { KEEP(*flash_boot.o(.rela.got )) }
	".rel.sdata_*flash_boot.o" 	: { KEEP(*flash_boot.o(.rel.sdata .rel.sdata.* .rel.gnu.linkonce.s.* )) }
	".rela.sdata_*flash_boot.o" 	: { KEEP(*flash_boot.o(.rela.sdata .rela.sdata.* .rela.gnu.linkonce.s.* )) }
	".rel.sbss_*flash_boot.o" 	: { KEEP(*flash_boot.o(.rel.sbss .rel.sbss.* .rel.gnu.linkonce.sb.* )) }
	".rela.sbss_*flash_boot.o" 	: { KEEP(*flash_boot.o(.rela.sbss .rela.sbss.* .rela.gnu.linkonce.sb.* )) }
	".rel.sdata2_*flash_boot.o" 	: { KEEP(*flash_boot.o(.rel.sdata2 .rel.sdata2.* .rel.gnu.linkonce.s2.* )) }
	".rela.sdata2_*flash_boot.o" 	: { KEEP(*flash_boot.o(.rela.sdata2 .rela.sdata2.* .rela.gnu.linkonce.s2.* )) }
	".rel.sbss2_*flash_boot.o" 	: { KEEP(*flash_boot.o(.rel.sbss2 .rel.sbss2.* .rel.gnu.linkonce.sb2.* )) }
	".rela.sbss2_*flash_boot.o" 	: { KEEP(*flash_boot.o(.rela.sbss2 .rela.sbss2.* .rela.gnu.linkonce.sb2.* )) }
	".rel.bss_*flash_boot.o" 	: { KEEP(*flash_boot.o(.rel.bss .rel.bss.* .rel.gnu.linkonce.b.* )) }
	".rela.bss_*flash_boot.o" 	: { KEEP(*flash_boot.o(.rela.bss .rela.bss.* .rela.gnu.linkonce.b.* )) }
	".rel.plt_*flash_boot.o" 	: { KEEP(*flash_boot.o(.rel.plt )) }
	".rela.plt_*flash_boot.o" 	: { KEEP(*flash_boot.o(.rela.plt )) }
	".init_*flash_boot.o" 	: { KEEP(*flash_boot.o(.init )) }
	".plt_*flash_boot.o" 	: { KEEP(*flash_boot.o(.plt )) }
	".text_*flash_boot.o" 	: { KEEP(*flash_boot.o(.text .stub .text.* .gnu.linkonce.t.* )) KEEP(*flash_boot.o(.text.*personality* )) KEEP(*flash_boot.o(.gnu.warning )) . = ALIGN(4); }
	".fini_*flash_boot.o" 	: { KEEP(*flash_boot.o(.fini )) }
	".ex9.itable_*flash_boot.o" 	: { KEEP(*flash_boot.o(.ex9.itable )) }
	PROVIDE (__etext = .);
	PROVIDE (_etext = .);
	PROVIDE (etext = .);
	".rodata_*flash_boot.o" 	: { KEEP(*flash_boot.o(.rodata .rodata.* .gnu.linkonce.r.* )) }
	".rodata1_*flash_boot.o" 	: { KEEP(*flash_boot.o(.rodata1 )) }
	".sdata2_*flash_boot.o" 	: { KEEP(*flash_boot.o(.sdata2 .sdata2.* .gnu.linkonce.s2.* )) }
	".sbss2_*flash_boot.o" 	: { KEEP(*flash_boot.o(.sbss2 .sbss2.* .gnu.linkonce.sb2.* )) }
	".eh_frame_hdr_*flash_boot.o" 	: { KEEP(*flash_boot.o(.eh_frame_hdr )) }
	".nds32_init_*flash_boot_ota.o" 	: { KEEP(*flash_boot_ota.o(.nds32_init )) }
	".interp_*flash_boot_ota.o" 	: { KEEP(*flash_boot_ota.o(.interp )) }
	".hash_*flash_boot_ota.o" 	: { KEEP(*flash_boot_ota.o(.hash )) }
	".dynsym_*flash_boot_ota.o" 	: { KEEP(*flash_boot_ota.o(.dynsym )) }
	".dynstr_*flash_boot_ota.o" 	: { KEEP(*flash_boot_ota.o(.dynstr )) }
	".gnu.version_*flash_boot_ota.o" 	: { KEEP(*flash_boot_ota.o(.gnu.version )) }
	".gnu.version_d_*flash_boot_ota.o" 	: { KEEP(*flash_boot_ota.o(.gnu.version_d )) }
	".gnu.version_r_*flash_boot_ota.o" 	: { KEEP(*flash_boot_ota.o(.gnu.version_r )) }
	".rel.init_*flash_boot_ota.o" 	: { KEEP(*flash_boot_ota.o(.rel.init )) }
	".rela.init_*flash_boot_ota.o" 	: { KEEP(*flash_boot_ota.o(.rela.init )) }
	".rel.text_*flash_boot_ota.o" 	: { KEEP(*flash_boot_ota.o(.rel.text .rel.text.* .rel.gnu.linkonce.t.* )) }
	".rela.text_*flash_boot_ota.o" 	: { KEEP(*flash_boot_ota.o(.rela.text .rela.text.* .rela.gnu.linkonce.t.* )) }
	".rel.fini_*flash_boot_ota.o" 	: { KEEP(*flash_boot_ota.o(.rel.fini )) }
	".rela.fini_*flash_boot_ota.o" 	: { KEEP(*flash_boot_ota.o(.rela.fini )) }
	".rel.rodata_*flash_boot_ota.o" 	: { KEEP(*flash_boot_ota.o(.rel.rodata .rel.rodata.* .rel.gnu.linkonce.r.* )) }
	".rela.rodata_*flash_boot_ota.o" 	: { KEEP(*flash_boot_ota.o(.rela.rodata .rela.rodata.* .rela.gnu.linkonce.r.* )) }
	".rel.data.rel.ro_*flash_boot_ota.o" 	: { KEEP(*flash_boot_ota.o(.rel.data.rel.ro* )) }
	".rela.data.rel.ro_*flash_boot_ota.o" 	: { KEEP(*flash_boot_ota.o(.rel.data.rel.ro* )) }
	".rel.data_*flash_boot_ota.o" 	: { KEEP(*flash_boot_ota.o(.rel.data .rel.data.* .rel.gnu.linkonce.d.* )) }
	".rela.data_*flash_boot_ota.o" 	: { KEEP(*flash_boot_ota.o(.rela.data .rela.data.* .rela.gnu.linkonce.d.* )) }
	".rel.tdata_*flash_boot_ota.o" 	: { KEEP(*flash_boot_ota.o(.rel.tdata .rel.tdata.* .rel.gnu.linkonce.td.* )) }
	".rela.tdata_*flash_boot_ota.o" 	: { KEEP(*flash_boot_ota.o(.rela.tdata .rela.tdata.* .rela.gnu.linkonce.td.* )) }
	".rel.tbss_*flash_boot_ota.o" 	: { KEEP(*flash_boot_ota.o(.rel.tbss .rel.tbss.* .rel.gnu.linkonce.tb.* )) }
	".rela.tbss_*flash_boot_ota.o" 	: { KEEP(*flash_boot_ota.o(.rela.tbss .rela.tbss.* .rela.gnu.linkonce.tb.* )) }
	".rel.ctors_*flash_boot_ota.o" 	: { KEEP(*flash_boot_ota.o(.rel.ctors )) }
	".rela.ctors_*flash_boot_ota.o" 	: { KEEP(*flash_boot_ota.o(.rela.ctors )) }
	".rel.dtors_*flash_boot_ota.o" 	: { KEEP(*flash_boot_ota.o(.rel.dtors )) }
	".rela.dtors_*flash_boot_ota.o" 	: { KEEP(*flash_boot_ota.o(.rela.dtors )) }
	".rela.dyn_*flash_boot_ota.o" 	: { KEEP(*flash_boot_ota.o(rela.dyn )) KEEP(*flash_boot_ota.o(.rela__libc_subfreeres )) KEEP(*flash_boot_ota.o(.rela__libc_atexit )) KEEP(*flash_boot_ota.o(.rela__libc_thread_subfreeres )) KEEP(*flash_boot_ota.o(.rela.init_array )) KEEP(*flash_boot_ota.o(.rela.fini_array )) }
	".rel.got_*flash_boot_ota.o" 	: { KEEP(*flash_boot_ota.o(.rel.got )) }
	".rela.got_*flash_boot_ota.o" 	: { KEEP(*flash_boot_ota.o(.rela.got )) }
	".rel.sdata_*flash_boot_ota.o" 	: { KEEP(*flash_boot_ota.o(.rel.sdata .rel.sdata.* .rel.gnu.linkonce.s.* )) }
	".rela.sdata_*flash_boot_ota.o" 	: { KEEP(*flash_boot_ota.o(.rela.sdata .rela.sdata.* .rela.gnu.linkonce.s.* )) }
	".rel.sbss_*flash_boot_ota.o" 	: { KEEP(*flash_boot_ota.o(.rel.sbss .rel.sbss.* .rel.gnu.linkonce.sb.* )) }
	".rela.sbss_*flash_boot_ota.o" 	: { KEEP(*flash_boot_ota.o(.rela.sbss .rela.sbss.* .rela.gnu.linkonce.sb.* )) }
	".rel.sdata2_*flash_boot_ota.o" 	: { KEEP(*flash_boot_ota.o(.rel.sdata2 .rel.sdata2.* .rel.gnu.linkonce.s2.* )) }
	".rela.sdata2_*flash_boot_ota.o" 	: { KEEP(*flash_boot_ota.o(.rela.sdata2 .rela.sdata2.* .rela.gnu.linkonce.s2.* )) }
	".rel.sbss2_*flash_boot_ota.o" 	: { KEEP(*flash_boot_ota.o(.rel.sbss2 .rel.sbss2.* .rel.gnu.linkonce.sb2.* )) }
	".rela.sbss2_*flash_boot_ota.o" 	: { KEEP(*flash_boot_ota.o(.rela.sbss2 .rela.sbss2.* .rela.gnu.linkonce.sb2.* )) }
	".rel.bss_*flash_boot_ota.o" 	: { KEEP(*flash_boot_ota.o(.rel.bss .rel.bss.* .rel.gnu.linkonce.b.* )) }
	".rela.bss_*flash_boot_ota.o" 	: { KEEP(*flash_boot_ota.o(.rela.bss .rela.bss.* .rela.gnu.linkonce.b.* )) }
	".rel.plt_*flash_boot_ota.o" 	: { KEEP(*flash_boot_ota.o(.rel.plt )) }
	".rela.plt_*flash_boot_ota.o" 	: { KEEP(*flash_boot_ota.o(.rela.plt )) }
	".init_*flash_boot_ota.o" 	: { KEEP(*flash_boot_ota.o(.init )) }
	".plt_*flash_boot_ota.o" 	: { KEEP(*flash_boot_ota.o(.plt )) }
	".text_*flash_boot_ota.o" 	: { KEEP(*flash_boot_ota.o(.text .stub .text.* .gnu.linkonce.t.* )) KEEP(*flash_boot_ota.o(.text.*personality* )) KEEP(*flash_boot_ota.o(.gnu.warning )) . = ALIGN(4); }
	".fini_*flash_boot_ota.o" 	: { KEEP(*flash_boot_ota.o(.fini )) }
	".ex9.itable_*flash_boot_ota.o" 	: { KEEP(*flash_boot_ota.o(.ex9.itable )) }
	PROVIDE (__etext = .);
	PROVIDE (_etext = .);
	PROVIDE (etext = .);
	".rodata_*flash_boot_ota.o" 	: { KEEP(*flash_boot_ota.o(.rodata .rodata.* .gnu.linkonce.r.* )) }
	".rodata1_*flash_boot_ota.o" 	: { KEEP(*flash_boot_ota.o(.rodata1 )) }
	".sdata2_*flash_boot_ota.o" 	: { KEEP(*flash_boot_ota.o(.sdata2 .sdata2.* .gnu.linkonce.s2.* )) }
	".sbss2_*flash_boot_ota.o" 	: { KEEP(*flash_boot_ota.o(.sbss2 .sbss2.* .gnu.linkonce.sb2.* )) }
	".eh_frame_hdr_*flash_boot_ota.o" 	: { KEEP(*flash_boot_ota.o(.eh_frame_hdr )) }
	__sdk_code2_start =  LOADADDR (".nds32_init_*dual_core.o");
	".nds32_init_*dual_core.o" 	: { KEEP(*dual_core.o(.nds32_init )) }
	".interp_*dual_core.o" 	: { KEEP(*dual_core.o(.interp )) }
	".hash_*dual_core.o" 	: { KEEP(*dual_core.o(.hash )) }
	".dynsym_*dual_core.o" 	: { KEEP(*dual_core.o(.dynsym )) }
	".dynstr_*dual_core.o" 	: { KEEP(*dual_core.o(.dynstr )) }
	".gnu.version_*dual_core.o" 	: { KEEP(*dual_core.o(.gnu.version )) }
	".gnu.version_d_*dual_core.o" 	: { KEEP(*dual_core.o(.gnu.version_d )) }
	".gnu.version_r_*dual_core.o" 	: { KEEP(*dual_core.o(.gnu.version_r )) }
	".rel.init_*dual_core.o" 	: { KEEP(*dual_core.o(.rel.init )) }
	".rela.init_*dual_core.o" 	: { KEEP(*dual_core.o(.rela.init )) }
	".rel.text_*dual_core.o" 	: { KEEP(*dual_core.o(.rel.text .rel.text.* .rel.gnu.linkonce.t.* )) }
	".rela.text_*dual_core.o" 	: { KEEP(*dual_core.o(.rela.text .rela.text.* .rela.gnu.linkonce.t.* )) }
	".rel.fini_*dual_core.o" 	: { KEEP(*dual_core.o(.rel.fini )) }
	".rela.fini_*dual_core.o" 	: { KEEP(*dual_core.o(.rela.fini )) }
	".rel.rodata_*dual_core.o" 	: { KEEP(*dual_core.o(.rel.rodata .rel.rodata.* .rel.gnu.linkonce.r.* )) }
	".rela.rodata_*dual_core.o" 	: { KEEP(*dual_core.o(.rela.rodata .rela.rodata.* .rela.gnu.linkonce.r.* )) }
	".rel.data.rel.ro_*dual_core.o" 	: { KEEP(*dual_core.o(.rel.data.rel.ro* )) }
	".rela.data.rel.ro_*dual_core.o" 	: { KEEP(*dual_core.o(.rel.data.rel.ro* )) }
	".rel.data_*dual_core.o" 	: { KEEP(*dual_core.o(.rel.data .rel.data.* .rel.gnu.linkonce.d.* )) }
	".rela.data_*dual_core.o" 	: { KEEP(*dual_core.o(.rela.data .rela.data.* .rela.gnu.linkonce.d.* )) }
	".rel.tdata_*dual_core.o" 	: { KEEP(*dual_core.o(.rel.tdata .rel.tdata.* .rel.gnu.linkonce.td.* )) }
	".rela.tdata_*dual_core.o" 	: { KEEP(*dual_core.o(.rela.tdata .rela.tdata.* .rela.gnu.linkonce.td.* )) }
	".rel.tbss_*dual_core.o" 	: { KEEP(*dual_core.o(.rel.tbss .rel.tbss.* .rel.gnu.linkonce.tb.* )) }
	".rela.tbss_*dual_core.o" 	: { KEEP(*dual_core.o(.rela.tbss .rela.tbss.* .rela.gnu.linkonce.tb.* )) }
	".rel.ctors_*dual_core.o" 	: { KEEP(*dual_core.o(.rel.ctors )) }
	".rela.ctors_*dual_core.o" 	: { KEEP(*dual_core.o(.rela.ctors )) }
	".rel.dtors_*dual_core.o" 	: { KEEP(*dual_core.o(.rel.dtors )) }
	".rela.dtors_*dual_core.o" 	: { KEEP(*dual_core.o(.rela.dtors )) }
	".rela.dyn_*dual_core.o" 	: { KEEP(*dual_core.o(rela.dyn )) KEEP(*dual_core.o(.rela__libc_subfreeres )) KEEP(*dual_core.o(.rela__libc_atexit )) KEEP(*dual_core.o(.rela__libc_thread_subfreeres )) KEEP(*dual_core.o(.rela.init_array )) KEEP(*dual_core.o(.rela.fini_array )) }
	".rel.got_*dual_core.o" 	: { KEEP(*dual_core.o(.rel.got )) }
	".rela.got_*dual_core.o" 	: { KEEP(*dual_core.o(.rela.got )) }
	".rel.sdata_*dual_core.o" 	: { KEEP(*dual_core.o(.rel.sdata .rel.sdata.* .rel.gnu.linkonce.s.* )) }
	".rela.sdata_*dual_core.o" 	: { KEEP(*dual_core.o(.rela.sdata .rela.sdata.* .rela.gnu.linkonce.s.* )) }
	".rel.sbss_*dual_core.o" 	: { KEEP(*dual_core.o(.rel.sbss .rel.sbss.* .rel.gnu.linkonce.sb.* )) }
	".rela.sbss_*dual_core.o" 	: { KEEP(*dual_core.o(.rela.sbss .rela.sbss.* .rela.gnu.linkonce.sb.* )) }
	".rel.sdata2_*dual_core.o" 	: { KEEP(*dual_core.o(.rel.sdata2 .rel.sdata2.* .rel.gnu.linkonce.s2.* )) }
	".rela.sdata2_*dual_core.o" 	: { KEEP(*dual_core.o(.rela.sdata2 .rela.sdata2.* .rela.gnu.linkonce.s2.* )) }
	".rel.sbss2_*dual_core.o" 	: { KEEP(*dual_core.o(.rel.sbss2 .rel.sbss2.* .rel.gnu.linkonce.sb2.* )) }
	".rela.sbss2_*dual_core.o" 	: { KEEP(*dual_core.o(.rela.sbss2 .rela.sbss2.* .rela.gnu.linkonce.sb2.* )) }
	".rel.bss_*dual_core.o" 	: { KEEP(*dual_core.o(.rel.bss .rel.bss.* .rel.gnu.linkonce.b.* )) }
	".rela.bss_*dual_core.o" 	: { KEEP(*dual_core.o(.rela.bss .rela.bss.* .rela.gnu.linkonce.b.* )) }
	".rel.plt_*dual_core.o" 	: { KEEP(*dual_core.o(.rel.plt )) }
	".rela.plt_*dual_core.o" 	: { KEEP(*dual_core.o(.rela.plt )) }
	".init_*dual_core.o" 	: { KEEP(*dual_core.o(.init )) }
	".plt_*dual_core.o" 	: { KEEP(*dual_core.o(.plt )) }
	".text_*dual_core.o" 	: { KEEP(*dual_core.o(.text .stub .text.* .gnu.linkonce.t.* )) KEEP(*dual_core.o(.text.*personality* )) KEEP(*dual_core.o(.gnu.warning )) . = ALIGN(4); }
	".fini_*dual_core.o" 	: { KEEP(*dual_core.o(.fini )) }
	".ex9.itable_*dual_core.o" 	: { KEEP(*dual_core.o(.ex9.itable )) }
	PROVIDE (__etext = .);
	PROVIDE (_etext = .);
	PROVIDE (etext = .);
	".rodata_*dual_core.o" 	: { KEEP(*dual_core.o(.rodata .rodata.* .gnu.linkonce.r.* )) }
	".rodata1_*dual_core.o" 	: { KEEP(*dual_core.o(.rodata1 )) }
	".sdata2_*dual_core.o" 	: { KEEP(*dual_core.o(.sdata2 .sdata2.* .gnu.linkonce.s2.* )) }
	".sbss2_*dual_core.o" 	: { KEEP(*dual_core.o(.sbss2 .sbss2.* .gnu.linkonce.sb2.* )) }
	".eh_frame_hdr_*dual_core.o" 	: { KEEP(*dual_core.o(.eh_frame_hdr )) }
	".nds32_init_*dual_core_ota.o" 	: { KEEP(*dual_core_ota.o(.nds32_init )) }
	".interp_*dual_core_ota.o" 	: { KEEP(*dual_core_ota.o(.interp )) }
	".hash_*dual_core_ota.o" 	: { KEEP(*dual_core_ota.o(.hash )) }
	".dynsym_*dual_core_ota.o" 	: { KEEP(*dual_core_ota.o(.dynsym )) }
	".dynstr_*dual_core_ota.o" 	: { KEEP(*dual_core_ota.o(.dynstr )) }
	".gnu.version_*dual_core_ota.o" 	: { KEEP(*dual_core_ota.o(.gnu.version )) }
	".gnu.version_d_*dual_core_ota.o" 	: { KEEP(*dual_core_ota.o(.gnu.version_d )) }
	".gnu.version_r_*dual_core_ota.o" 	: { KEEP(*dual_core_ota.o(.gnu.version_r )) }
	".rel.init_*dual_core_ota.o" 	: { KEEP(*dual_core_ota.o(.rel.init )) }
	".rela.init_*dual_core_ota.o" 	: { KEEP(*dual_core_ota.o(.rela.init )) }
	".rel.text_*dual_core_ota.o" 	: { KEEP(*dual_core_ota.o(.rel.text .rel.text.* .rel.gnu.linkonce.t.* )) }
	".rela.text_*dual_core_ota.o" 	: { KEEP(*dual_core_ota.o(.rela.text .rela.text.* .rela.gnu.linkonce.t.* )) }
	".rel.fini_*dual_core_ota.o" 	: { KEEP(*dual_core_ota.o(.rel.fini )) }
	".rela.fini_*dual_core_ota.o" 	: { KEEP(*dual_core_ota.o(.rela.fini )) }
	".rel.rodata_*dual_core_ota.o" 	: { KEEP(*dual_core_ota.o(.rel.rodata .rel.rodata.* .rel.gnu.linkonce.r.* )) }
	".rela.rodata_*dual_core_ota.o" 	: { KEEP(*dual_core_ota.o(.rela.rodata .rela.rodata.* .rela.gnu.linkonce.r.* )) }
	".rel.data.rel.ro_*dual_core_ota.o" 	: { KEEP(*dual_core_ota.o(.rel.data.rel.ro* )) }
	".rela.data.rel.ro_*dual_core_ota.o" 	: { KEEP(*dual_core_ota.o(.rel.data.rel.ro* )) }
	".rel.data_*dual_core_ota.o" 	: { KEEP(*dual_core_ota.o(.rel.data .rel.data.* .rel.gnu.linkonce.d.* )) }
	".rela.data_*dual_core_ota.o" 	: { KEEP(*dual_core_ota.o(.rela.data .rela.data.* .rela.gnu.linkonce.d.* )) }
	".rel.tdata_*dual_core_ota.o" 	: { KEEP(*dual_core_ota.o(.rel.tdata .rel.tdata.* .rel.gnu.linkonce.td.* )) }
	".rela.tdata_*dual_core_ota.o" 	: { KEEP(*dual_core_ota.o(.rela.tdata .rela.tdata.* .rela.gnu.linkonce.td.* )) }
	".rel.tbss_*dual_core_ota.o" 	: { KEEP(*dual_core_ota.o(.rel.tbss .rel.tbss.* .rel.gnu.linkonce.tb.* )) }
	".rela.tbss_*dual_core_ota.o" 	: { KEEP(*dual_core_ota.o(.rela.tbss .rela.tbss.* .rela.gnu.linkonce.tb.* )) }
	".rel.ctors_*dual_core_ota.o" 	: { KEEP(*dual_core_ota.o(.rel.ctors )) }
	".rela.ctors_*dual_core_ota.o" 	: { KEEP(*dual_core_ota.o(.rela.ctors )) }
	".rel.dtors_*dual_core_ota.o" 	: { KEEP(*dual_core_ota.o(.rel.dtors )) }
	".rela.dtors_*dual_core_ota.o" 	: { KEEP(*dual_core_ota.o(.rela.dtors )) }
	".rela.dyn_*dual_core_ota.o" 	: { KEEP(*dual_core_ota.o(rela.dyn )) KEEP(*dual_core_ota.o(.rela__libc_subfreeres )) KEEP(*dual_core_ota.o(.rela__libc_atexit )) KEEP(*dual_core_ota.o(.rela__libc_thread_subfreeres )) KEEP(*dual_core_ota.o(.rela.init_array )) KEEP(*dual_core_ota.o(.rela.fini_array )) }
	".rel.got_*dual_core_ota.o" 	: { KEEP(*dual_core_ota.o(.rel.got )) }
	".rela.got_*dual_core_ota.o" 	: { KEEP(*dual_core_ota.o(.rela.got )) }
	".rel.sdata_*dual_core_ota.o" 	: { KEEP(*dual_core_ota.o(.rel.sdata .rel.sdata.* .rel.gnu.linkonce.s.* )) }
	".rela.sdata_*dual_core_ota.o" 	: { KEEP(*dual_core_ota.o(.rela.sdata .rela.sdata.* .rela.gnu.linkonce.s.* )) }
	".rel.sbss_*dual_core_ota.o" 	: { KEEP(*dual_core_ota.o(.rel.sbss .rel.sbss.* .rel.gnu.linkonce.sb.* )) }
	".rela.sbss_*dual_core_ota.o" 	: { KEEP(*dual_core_ota.o(.rela.sbss .rela.sbss.* .rela.gnu.linkonce.sb.* )) }
	".rel.sdata2_*dual_core_ota.o" 	: { KEEP(*dual_core_ota.o(.rel.sdata2 .rel.sdata2.* .rel.gnu.linkonce.s2.* )) }
	".rela.sdata2_*dual_core_ota.o" 	: { KEEP(*dual_core_ota.o(.rela.sdata2 .rela.sdata2.* .rela.gnu.linkonce.s2.* )) }
	".rel.sbss2_*dual_core_ota.o" 	: { KEEP(*dual_core_ota.o(.rel.sbss2 .rel.sbss2.* .rel.gnu.linkonce.sb2.* )) }
	".rela.sbss2_*dual_core_ota.o" 	: { KEEP(*dual_core_ota.o(.rela.sbss2 .rela.sbss2.* .rela.gnu.linkonce.sb2.* )) }
	".rel.bss_*dual_core_ota.o" 	: { KEEP(*dual_core_ota.o(.rel.bss .rel.bss.* .rel.gnu.linkonce.b.* )) }
	".rela.bss_*dual_core_ota.o" 	: { KEEP(*dual_core_ota.o(.rela.bss .rela.bss.* .rela.gnu.linkonce.b.* )) }
	".rel.plt_*dual_core_ota.o" 	: { KEEP(*dual_core_ota.o(.rel.plt )) }
	".rela.plt_*dual_core_ota.o" 	: { KEEP(*dual_core_ota.o(.rela.plt )) }
	".init_*dual_core_ota.o" 	: { KEEP(*dual_core_ota.o(.init )) }
	".plt_*dual_core_ota.o" 	: { KEEP(*dual_core_ota.o(.plt )) }
	".text_*dual_core_ota.o" 	: { KEEP(*dual_core_ota.o(.text .stub .text.* .gnu.linkonce.t.* )) KEEP(*dual_core_ota.o(.text.*personality* )) KEEP(*dual_core_ota.o(.gnu.warning )) . = ALIGN(4); }
	".fini_*dual_core_ota.o" 	: { KEEP(*dual_core_ota.o(.fini )) }
	".ex9.itable_*dual_core_ota.o" 	: { KEEP(*dual_core_ota.o(.ex9.itable )) }
	PROVIDE (__etext = .);
	PROVIDE (_etext = .);
	PROVIDE (etext = .);
	".rodata_*dual_core_ota.o" 	: { KEEP(*dual_core_ota.o(.rodata .rodata.* .gnu.linkonce.r.* )) }
	".rodata1_*dual_core_ota.o" 	: { KEEP(*dual_core_ota.o(.rodata1 )) }
	".sdata2_*dual_core_ota.o" 	: { KEEP(*dual_core_ota.o(.sdata2 .sdata2.* .gnu.linkonce.s2.* )) }
	".sbss2_*dual_core_ota.o" 	: { KEEP(*dual_core_ota.o(.sbss2 .sbss2.* .gnu.linkonce.sb2.* )) }
	".eh_frame_hdr_*dual_core_ota.o" 	: { KEEP(*dual_core_ota.o(.eh_frame_hdr )) }
	__sdk_code_start =  LOADADDR (.vector);
	.vector 	: { KEEP(*(.vector )) }
	.stub_section 	: { KEEP(*(.stub_section )) }
	".nds32_init_*spi_flash.o" 	: { KEEP(*spi_flash.o(.nds32_init )) }
	".interp_*spi_flash.o" 	: { KEEP(*spi_flash.o(.interp )) }
	".hash_*spi_flash.o" 	: { KEEP(*spi_flash.o(.hash )) }
	".dynsym_*spi_flash.o" 	: { KEEP(*spi_flash.o(.dynsym )) }
	".dynstr_*spi_flash.o" 	: { KEEP(*spi_flash.o(.dynstr )) }
	".gnu.version_*spi_flash.o" 	: { KEEP(*spi_flash.o(.gnu.version )) }
	".gnu.version_d_*spi_flash.o" 	: { KEEP(*spi_flash.o(.gnu.version_d )) }
	".gnu.version_r_*spi_flash.o" 	: { KEEP(*spi_flash.o(.gnu.version_r )) }
	".rel.init_*spi_flash.o" 	: { KEEP(*spi_flash.o(.rel.init )) }
	".rela.init_*spi_flash.o" 	: { KEEP(*spi_flash.o(.rela.init )) }
	".rel.text_*spi_flash.o" 	: { KEEP(*spi_flash.o(.rel.text .rel.text.* .rel.gnu.linkonce.t.* )) }
	".rela.text_*spi_flash.o" 	: { KEEP(*spi_flash.o(.rela.text .rela.text.* .rela.gnu.linkonce.t.* )) }
	".rel.fini_*spi_flash.o" 	: { KEEP(*spi_flash.o(.rel.fini )) }
	".rela.fini_*spi_flash.o" 	: { KEEP(*spi_flash.o(.rela.fini )) }
	".rel.rodata_*spi_flash.o" 	: { KEEP(*spi_flash.o(.rel.rodata .rel.rodata.* .rel.gnu.linkonce.r.* )) }
	".rela.rodata_*spi_flash.o" 	: { KEEP(*spi_flash.o(.rela.rodata .rela.rodata.* .rela.gnu.linkonce.r.* )) }
	".rel.data.rel.ro_*spi_flash.o" 	: { KEEP(*spi_flash.o(.rel.data.rel.ro* )) }
	".rela.data.rel.ro_*spi_flash.o" 	: { KEEP(*spi_flash.o(.rel.data.rel.ro* )) }
	".rel.data_*spi_flash.o" 	: { KEEP(*spi_flash.o(.rel.data .rel.data.* .rel.gnu.linkonce.d.* )) }
	".rela.data_*spi_flash.o" 	: { KEEP(*spi_flash.o(.rela.data .rela.data.* .rela.gnu.linkonce.d.* )) }
	".rel.tdata_*spi_flash.o" 	: { KEEP(*spi_flash.o(.rel.tdata .rel.tdata.* .rel.gnu.linkonce.td.* )) }
	".rela.tdata_*spi_flash.o" 	: { KEEP(*spi_flash.o(.rela.tdata .rela.tdata.* .rela.gnu.linkonce.td.* )) }
	".rel.tbss_*spi_flash.o" 	: { KEEP(*spi_flash.o(.rel.tbss .rel.tbss.* .rel.gnu.linkonce.tb.* )) }
	".rela.tbss_*spi_flash.o" 	: { KEEP(*spi_flash.o(.rela.tbss .rela.tbss.* .rela.gnu.linkonce.tb.* )) }
	".rel.ctors_*spi_flash.o" 	: { KEEP(*spi_flash.o(.rel.ctors )) }
	".rela.ctors_*spi_flash.o" 	: { KEEP(*spi_flash.o(.rela.ctors )) }
	".rel.dtors_*spi_flash.o" 	: { KEEP(*spi_flash.o(.rel.dtors )) }
	".rela.dtors_*spi_flash.o" 	: { KEEP(*spi_flash.o(.rela.dtors )) }
	".rela.dyn_*spi_flash.o" 	: { KEEP(*spi_flash.o(rela.dyn )) KEEP(*spi_flash.o(.rela__libc_subfreeres )) KEEP(*spi_flash.o(.rela__libc_atexit )) KEEP(*spi_flash.o(.rela__libc_thread_subfreeres )) KEEP(*spi_flash.o(.rela.init_array )) KEEP(*spi_flash.o(.rela.fini_array )) }
	".rel.got_*spi_flash.o" 	: { KEEP(*spi_flash.o(.rel.got )) }
	".rela.got_*spi_flash.o" 	: { KEEP(*spi_flash.o(.rela.got )) }
	".rel.sdata_*spi_flash.o" 	: { KEEP(*spi_flash.o(.rel.sdata .rel.sdata.* .rel.gnu.linkonce.s.* )) }
	".rela.sdata_*spi_flash.o" 	: { KEEP(*spi_flash.o(.rela.sdata .rela.sdata.* .rela.gnu.linkonce.s.* )) }
	".rel.sbss_*spi_flash.o" 	: { KEEP(*spi_flash.o(.rel.sbss .rel.sbss.* .rel.gnu.linkonce.sb.* )) }
	".rela.sbss_*spi_flash.o" 	: { KEEP(*spi_flash.o(.rela.sbss .rela.sbss.* .rela.gnu.linkonce.sb.* )) }
	".rel.sdata2_*spi_flash.o" 	: { KEEP(*spi_flash.o(.rel.sdata2 .rel.sdata2.* .rel.gnu.linkonce.s2.* )) }
	".rela.sdata2_*spi_flash.o" 	: { KEEP(*spi_flash.o(.rela.sdata2 .rela.sdata2.* .rela.gnu.linkonce.s2.* )) }
	".rel.sbss2_*spi_flash.o" 	: { KEEP(*spi_flash.o(.rel.sbss2 .rel.sbss2.* .rel.gnu.linkonce.sb2.* )) }
	".rela.sbss2_*spi_flash.o" 	: { KEEP(*spi_flash.o(.rela.sbss2 .rela.sbss2.* .rela.gnu.linkonce.sb2.* )) }
	".rel.bss_*spi_flash.o" 	: { KEEP(*spi_flash.o(.rel.bss .rel.bss.* .rel.gnu.linkonce.b.* )) }
	".rela.bss_*spi_flash.o" 	: { KEEP(*spi_flash.o(.rela.bss .rela.bss.* .rela.gnu.linkonce.b.* )) }
	".rel.plt_*spi_flash.o" 	: { KEEP(*spi_flash.o(.rel.plt )) }
	".rela.plt_*spi_flash.o" 	: { KEEP(*spi_flash.o(.rela.plt )) }
	".init_*spi_flash.o" 	: { KEEP(*spi_flash.o(.init )) }
	".plt_*spi_flash.o" 	: { KEEP(*spi_flash.o(.plt )) }
	".text_*spi_flash.o" 	: { KEEP(*spi_flash.o(.text .stub .text.* .gnu.linkonce.t.* )) KEEP(*spi_flash.o(.text.*personality* )) KEEP(*spi_flash.o(.gnu.warning )) . = ALIGN(4); }
	".fini_*spi_flash.o" 	: { KEEP(*spi_flash.o(.fini )) }
	".ex9.itable_*spi_flash.o" 	: { KEEP(*spi_flash.o(.ex9.itable )) }
	PROVIDE (__etext = .);
	PROVIDE (_etext = .);
	PROVIDE (etext = .);
	".rodata_*spi_flash.o" 	: { KEEP(*spi_flash.o(.rodata .rodata.* .gnu.linkonce.r.* )) }
	".rodata1_*spi_flash.o" 	: { KEEP(*spi_flash.o(.rodata1 )) }
	".sdata2_*spi_flash.o" 	: { KEEP(*spi_flash.o(.sdata2 .sdata2.* .gnu.linkonce.s2.* )) }
	".sbss2_*spi_flash.o" 	: { KEEP(*spi_flash.o(.sbss2 .sbss2.* .gnu.linkonce.sb2.* )) }
	".eh_frame_hdr_*spi_flash.o" 	: { KEEP(*spi_flash.o(.eh_frame_hdr )) }
	.int_stack_op 	: { KEEP(*(.int_stack_op )) }
	.driver.isr 	: { KEEP(*(.driver.isr )) }
	".driver.isr.*_*" 	: { KEEP(*(.driver.isr.* )) }
	.tcm_section 	: { KEEP(*(.tcm_section )) }
	".tcm_section.*_*" 	: { KEEP(*(.tcm_section.* )) }
	. = . + 0;
	. = ALIGN(0x8000);
	__ilm_lmastart = ADDR(".nds32_init_*mdct.c.o");
	".nds32_init_*mdct.c.o" 	: { KEEP(*mdct.c.o(.nds32_init )) }
	".interp_*mdct.c.o" 	: { KEEP(*mdct.c.o(.interp )) }
	".hash_*mdct.c.o" 	: { KEEP(*mdct.c.o(.hash )) }
	".dynsym_*mdct.c.o" 	: { KEEP(*mdct.c.o(.dynsym )) }
	".dynstr_*mdct.c.o" 	: { KEEP(*mdct.c.o(.dynstr )) }
	".gnu.version_*mdct.c.o" 	: { KEEP(*mdct.c.o(.gnu.version )) }
	".gnu.version_d_*mdct.c.o" 	: { KEEP(*mdct.c.o(.gnu.version_d )) }
	".gnu.version_r_*mdct.c.o" 	: { KEEP(*mdct.c.o(.gnu.version_r )) }
	".rel.init_*mdct.c.o" 	: { KEEP(*mdct.c.o(.rel.init )) }
	".rela.init_*mdct.c.o" 	: { KEEP(*mdct.c.o(.rela.init )) }
	".rel.text_*mdct.c.o" 	: { KEEP(*mdct.c.o(.rel.text .rel.text.* .rel.gnu.linkonce.t.* )) }
	".rela.text_*mdct.c.o" 	: { KEEP(*mdct.c.o(.rela.text .rela.text.* .rela.gnu.linkonce.t.* )) }
	".rel.fini_*mdct.c.o" 	: { KEEP(*mdct.c.o(.rel.fini )) }
	".rela.fini_*mdct.c.o" 	: { KEEP(*mdct.c.o(.rela.fini )) }
	".rel.rodata_*mdct.c.o" 	: { KEEP(*mdct.c.o(.rel.rodata .rel.rodata.* .rel.gnu.linkonce.r.* )) }
	".rela.rodata_*mdct.c.o" 	: { KEEP(*mdct.c.o(.rela.rodata .rela.rodata.* .rela.gnu.linkonce.r.* )) }
	".rel.data.rel.ro_*mdct.c.o" 	: { KEEP(*mdct.c.o(.rel.data.rel.ro* )) }
	".rela.data.rel.ro_*mdct.c.o" 	: { KEEP(*mdct.c.o(.rel.data.rel.ro* )) }
	".rel.data_*mdct.c.o" 	: { KEEP(*mdct.c.o(.rel.data .rel.data.* .rel.gnu.linkonce.d.* )) }
	".rela.data_*mdct.c.o" 	: { KEEP(*mdct.c.o(.rela.data .rela.data.* .rela.gnu.linkonce.d.* )) }
	".rel.tdata_*mdct.c.o" 	: { KEEP(*mdct.c.o(.rel.tdata .rel.tdata.* .rel.gnu.linkonce.td.* )) }
	".rela.tdata_*mdct.c.o" 	: { KEEP(*mdct.c.o(.rela.tdata .rela.tdata.* .rela.gnu.linkonce.td.* )) }
	".rel.tbss_*mdct.c.o" 	: { KEEP(*mdct.c.o(.rel.tbss .rel.tbss.* .rel.gnu.linkonce.tb.* )) }
	".rela.tbss_*mdct.c.o" 	: { KEEP(*mdct.c.o(.rela.tbss .rela.tbss.* .rela.gnu.linkonce.tb.* )) }
	".rel.ctors_*mdct.c.o" 	: { KEEP(*mdct.c.o(.rel.ctors )) }
	".rela.ctors_*mdct.c.o" 	: { KEEP(*mdct.c.o(.rela.ctors )) }
	".rel.dtors_*mdct.c.o" 	: { KEEP(*mdct.c.o(.rel.dtors )) }
	".rela.dtors_*mdct.c.o" 	: { KEEP(*mdct.c.o(.rela.dtors )) }
	".rela.dyn_*mdct.c.o" 	: { KEEP(*mdct.c.o(rela.dyn )) KEEP(*mdct.c.o(.rela__libc_subfreeres )) KEEP(*mdct.c.o(.rela__libc_atexit )) KEEP(*mdct.c.o(.rela__libc_thread_subfreeres )) KEEP(*mdct.c.o(.rela.init_array )) KEEP(*mdct.c.o(.rela.fini_array )) }
	".rel.got_*mdct.c.o" 	: { KEEP(*mdct.c.o(.rel.got )) }
	".rela.got_*mdct.c.o" 	: { KEEP(*mdct.c.o(.rela.got )) }
	".rel.sdata_*mdct.c.o" 	: { KEEP(*mdct.c.o(.rel.sdata .rel.sdata.* .rel.gnu.linkonce.s.* )) }
	".rela.sdata_*mdct.c.o" 	: { KEEP(*mdct.c.o(.rela.sdata .rela.sdata.* .rela.gnu.linkonce.s.* )) }
	".rel.sbss_*mdct.c.o" 	: { KEEP(*mdct.c.o(.rel.sbss .rel.sbss.* .rel.gnu.linkonce.sb.* )) }
	".rela.sbss_*mdct.c.o" 	: { KEEP(*mdct.c.o(.rela.sbss .rela.sbss.* .rela.gnu.linkonce.sb.* )) }
	".rel.sdata2_*mdct.c.o" 	: { KEEP(*mdct.c.o(.rel.sdata2 .rel.sdata2.* .rel.gnu.linkonce.s2.* )) }
	".rela.sdata2_*mdct.c.o" 	: { KEEP(*mdct.c.o(.rela.sdata2 .rela.sdata2.* .rela.gnu.linkonce.s2.* )) }
	".rel.sbss2_*mdct.c.o" 	: { KEEP(*mdct.c.o(.rel.sbss2 .rel.sbss2.* .rel.gnu.linkonce.sb2.* )) }
	".rela.sbss2_*mdct.c.o" 	: { KEEP(*mdct.c.o(.rela.sbss2 .rela.sbss2.* .rela.gnu.linkonce.sb2.* )) }
	".rel.bss_*mdct.c.o" 	: { KEEP(*mdct.c.o(.rel.bss .rel.bss.* .rel.gnu.linkonce.b.* )) }
	".rela.bss_*mdct.c.o" 	: { KEEP(*mdct.c.o(.rela.bss .rela.bss.* .rela.gnu.linkonce.b.* )) }
	".rel.plt_*mdct.c.o" 	: { KEEP(*mdct.c.o(.rel.plt )) }
	".rela.plt_*mdct.c.o" 	: { KEEP(*mdct.c.o(.rela.plt )) }
	".init_*mdct.c.o" 	: { KEEP(*mdct.c.o(.init )) }
	".plt_*mdct.c.o" 	: { KEEP(*mdct.c.o(.plt )) }
	".text_*mdct.c.o" 	: { KEEP(*mdct.c.o(.text .stub .text.* .gnu.linkonce.t.* )) KEEP(*mdct.c.o(.text.*personality* )) KEEP(*mdct.c.o(.gnu.warning )) . = ALIGN(4); }
	".fini_*mdct.c.o" 	: { KEEP(*mdct.c.o(.fini )) }
	".ex9.itable_*mdct.c.o" 	: { KEEP(*mdct.c.o(.ex9.itable )) }
	PROVIDE (__etext = .);
	PROVIDE (_etext = .);
	PROVIDE (etext = .);
	".rodata_*mdct.c.o" 	: { KEEP(*mdct.c.o(.rodata .rodata.* .gnu.linkonce.r.* )) }
	".rodata1_*mdct.c.o" 	: { KEEP(*mdct.c.o(.rodata1 )) }
	".sdata2_*mdct.c.o" 	: { KEEP(*mdct.c.o(.sdata2 .sdata2.* .gnu.linkonce.s2.* )) }
	".sbss2_*mdct.c.o" 	: { KEEP(*mdct.c.o(.sbss2 .sbss2.* .gnu.linkonce.sb2.* )) }
	".eh_frame_hdr_*mdct.c.o" 	: { KEEP(*mdct.c.o(.eh_frame_hdr )) }
	".nds32_init_*lc3.c.o" 	: { KEEP(*lc3.c.o(.nds32_init )) }
	".interp_*lc3.c.o" 	: { KEEP(*lc3.c.o(.interp )) }
	".hash_*lc3.c.o" 	: { KEEP(*lc3.c.o(.hash )) }
	".dynsym_*lc3.c.o" 	: { KEEP(*lc3.c.o(.dynsym )) }
	".dynstr_*lc3.c.o" 	: { KEEP(*lc3.c.o(.dynstr )) }
	".gnu.version_*lc3.c.o" 	: { KEEP(*lc3.c.o(.gnu.version )) }
	".gnu.version_d_*lc3.c.o" 	: { KEEP(*lc3.c.o(.gnu.version_d )) }
	".gnu.version_r_*lc3.c.o" 	: { KEEP(*lc3.c.o(.gnu.version_r )) }
	".rel.init_*lc3.c.o" 	: { KEEP(*lc3.c.o(.rel.init )) }
	".rela.init_*lc3.c.o" 	: { KEEP(*lc3.c.o(.rela.init )) }
	".rel.text_*lc3.c.o" 	: { KEEP(*lc3.c.o(.rel.text .rel.text.* .rel.gnu.linkonce.t.* )) }
	".rela.text_*lc3.c.o" 	: { KEEP(*lc3.c.o(.rela.text .rela.text.* .rela.gnu.linkonce.t.* )) }
	".rel.fini_*lc3.c.o" 	: { KEEP(*lc3.c.o(.rel.fini )) }
	".rela.fini_*lc3.c.o" 	: { KEEP(*lc3.c.o(.rela.fini )) }
	".rel.rodata_*lc3.c.o" 	: { KEEP(*lc3.c.o(.rel.rodata .rel.rodata.* .rel.gnu.linkonce.r.* )) }
	".rela.rodata_*lc3.c.o" 	: { KEEP(*lc3.c.o(.rela.rodata .rela.rodata.* .rela.gnu.linkonce.r.* )) }
	".rel.data.rel.ro_*lc3.c.o" 	: { KEEP(*lc3.c.o(.rel.data.rel.ro* )) }
	".rela.data.rel.ro_*lc3.c.o" 	: { KEEP(*lc3.c.o(.rel.data.rel.ro* )) }
	".rel.data_*lc3.c.o" 	: { KEEP(*lc3.c.o(.rel.data .rel.data.* .rel.gnu.linkonce.d.* )) }
	".rela.data_*lc3.c.o" 	: { KEEP(*lc3.c.o(.rela.data .rela.data.* .rela.gnu.linkonce.d.* )) }
	".rel.tdata_*lc3.c.o" 	: { KEEP(*lc3.c.o(.rel.tdata .rel.tdata.* .rel.gnu.linkonce.td.* )) }
	".rela.tdata_*lc3.c.o" 	: { KEEP(*lc3.c.o(.rela.tdata .rela.tdata.* .rela.gnu.linkonce.td.* )) }
	".rel.tbss_*lc3.c.o" 	: { KEEP(*lc3.c.o(.rel.tbss .rel.tbss.* .rel.gnu.linkonce.tb.* )) }
	".rela.tbss_*lc3.c.o" 	: { KEEP(*lc3.c.o(.rela.tbss .rela.tbss.* .rela.gnu.linkonce.tb.* )) }
	".rel.ctors_*lc3.c.o" 	: { KEEP(*lc3.c.o(.rel.ctors )) }
	".rela.ctors_*lc3.c.o" 	: { KEEP(*lc3.c.o(.rela.ctors )) }
	".rel.dtors_*lc3.c.o" 	: { KEEP(*lc3.c.o(.rel.dtors )) }
	".rela.dtors_*lc3.c.o" 	: { KEEP(*lc3.c.o(.rela.dtors )) }
	".rela.dyn_*lc3.c.o" 	: { KEEP(*lc3.c.o(rela.dyn )) KEEP(*lc3.c.o(.rela__libc_subfreeres )) KEEP(*lc3.c.o(.rela__libc_atexit )) KEEP(*lc3.c.o(.rela__libc_thread_subfreeres )) KEEP(*lc3.c.o(.rela.init_array )) KEEP(*lc3.c.o(.rela.fini_array )) }
	".rel.got_*lc3.c.o" 	: { KEEP(*lc3.c.o(.rel.got )) }
	".rela.got_*lc3.c.o" 	: { KEEP(*lc3.c.o(.rela.got )) }
	".rel.sdata_*lc3.c.o" 	: { KEEP(*lc3.c.o(.rel.sdata .rel.sdata.* .rel.gnu.linkonce.s.* )) }
	".rela.sdata_*lc3.c.o" 	: { KEEP(*lc3.c.o(.rela.sdata .rela.sdata.* .rela.gnu.linkonce.s.* )) }
	".rel.sbss_*lc3.c.o" 	: { KEEP(*lc3.c.o(.rel.sbss .rel.sbss.* .rel.gnu.linkonce.sb.* )) }
	".rela.sbss_*lc3.c.o" 	: { KEEP(*lc3.c.o(.rela.sbss .rela.sbss.* .rela.gnu.linkonce.sb.* )) }
	".rel.sdata2_*lc3.c.o" 	: { KEEP(*lc3.c.o(.rel.sdata2 .rel.sdata2.* .rel.gnu.linkonce.s2.* )) }
	".rela.sdata2_*lc3.c.o" 	: { KEEP(*lc3.c.o(.rela.sdata2 .rela.sdata2.* .rela.gnu.linkonce.s2.* )) }
	".rel.sbss2_*lc3.c.o" 	: { KEEP(*lc3.c.o(.rel.sbss2 .rel.sbss2.* .rel.gnu.linkonce.sb2.* )) }
	".rela.sbss2_*lc3.c.o" 	: { KEEP(*lc3.c.o(.rela.sbss2 .rela.sbss2.* .rela.gnu.linkonce.sb2.* )) }
	".rel.bss_*lc3.c.o" 	: { KEEP(*lc3.c.o(.rel.bss .rel.bss.* .rel.gnu.linkonce.b.* )) }
	".rela.bss_*lc3.c.o" 	: { KEEP(*lc3.c.o(.rela.bss .rela.bss.* .rela.gnu.linkonce.b.* )) }
	".rel.plt_*lc3.c.o" 	: { KEEP(*lc3.c.o(.rel.plt )) }
	".rela.plt_*lc3.c.o" 	: { KEEP(*lc3.c.o(.rela.plt )) }
	".init_*lc3.c.o" 	: { KEEP(*lc3.c.o(.init )) }
	".plt_*lc3.c.o" 	: { KEEP(*lc3.c.o(.plt )) }
	".text_*lc3.c.o" 	: { KEEP(*lc3.c.o(.text .stub .text.* .gnu.linkonce.t.* )) KEEP(*lc3.c.o(.text.*personality* )) KEEP(*lc3.c.o(.gnu.warning )) . = ALIGN(4); }
	".fini_*lc3.c.o" 	: { KEEP(*lc3.c.o(.fini )) }
	".ex9.itable_*lc3.c.o" 	: { KEEP(*lc3.c.o(.ex9.itable )) }
	PROVIDE (__etext = .);
	PROVIDE (_etext = .);
	PROVIDE (etext = .);
	".rodata_*lc3.c.o" 	: { KEEP(*lc3.c.o(.rodata .rodata.* .gnu.linkonce.r.* )) }
	".rodata1_*lc3.c.o" 	: { KEEP(*lc3.c.o(.rodata1 )) }
	".sdata2_*lc3.c.o" 	: { KEEP(*lc3.c.o(.sdata2 .sdata2.* .gnu.linkonce.s2.* )) }
	".sbss2_*lc3.c.o" 	: { KEEP(*lc3.c.o(.sbss2 .sbss2.* .gnu.linkonce.sb2.* )) }
	".eh_frame_hdr_*lc3.c.o" 	: { KEEP(*lc3.c.o(.eh_frame_hdr )) }
	.startup_section 	: { KEEP(*(.startup_section )) }
	.ilm_section 	: { KEEP(*(.ilm_section )) }
	".ilm_section.*_*" 	: { KEEP(*(.ilm_section.* )) }
	".nds32_init_*lib_a-memcpy.o" 	: { KEEP(*lib_a-memcpy.o(.nds32_init )) }
	".interp_*lib_a-memcpy.o" 	: { KEEP(*lib_a-memcpy.o(.interp )) }
	".hash_*lib_a-memcpy.o" 	: { KEEP(*lib_a-memcpy.o(.hash )) }
	".dynsym_*lib_a-memcpy.o" 	: { KEEP(*lib_a-memcpy.o(.dynsym )) }
	".dynstr_*lib_a-memcpy.o" 	: { KEEP(*lib_a-memcpy.o(.dynstr )) }
	".gnu.version_*lib_a-memcpy.o" 	: { KEEP(*lib_a-memcpy.o(.gnu.version )) }
	".gnu.version_d_*lib_a-memcpy.o" 	: { KEEP(*lib_a-memcpy.o(.gnu.version_d )) }
	".gnu.version_r_*lib_a-memcpy.o" 	: { KEEP(*lib_a-memcpy.o(.gnu.version_r )) }
	".rel.init_*lib_a-memcpy.o" 	: { KEEP(*lib_a-memcpy.o(.rel.init )) }
	".rela.init_*lib_a-memcpy.o" 	: { KEEP(*lib_a-memcpy.o(.rela.init )) }
	".rel.text_*lib_a-memcpy.o" 	: { KEEP(*lib_a-memcpy.o(.rel.text .rel.text.* .rel.gnu.linkonce.t.* )) }
	".rela.text_*lib_a-memcpy.o" 	: { KEEP(*lib_a-memcpy.o(.rela.text .rela.text.* .rela.gnu.linkonce.t.* )) }
	".rel.fini_*lib_a-memcpy.o" 	: { KEEP(*lib_a-memcpy.o(.rel.fini )) }
	".rela.fini_*lib_a-memcpy.o" 	: { KEEP(*lib_a-memcpy.o(.rela.fini )) }
	".rel.rodata_*lib_a-memcpy.o" 	: { KEEP(*lib_a-memcpy.o(.rel.rodata .rel.rodata.* .rel.gnu.linkonce.r.* )) }
	".rela.rodata_*lib_a-memcpy.o" 	: { KEEP(*lib_a-memcpy.o(.rela.rodata .rela.rodata.* .rela.gnu.linkonce.r.* )) }
	".rel.data.rel.ro_*lib_a-memcpy.o" 	: { KEEP(*lib_a-memcpy.o(.rel.data.rel.ro* )) }
	".rela.data.rel.ro_*lib_a-memcpy.o" 	: { KEEP(*lib_a-memcpy.o(.rel.data.rel.ro* )) }
	".rel.data_*lib_a-memcpy.o" 	: { KEEP(*lib_a-memcpy.o(.rel.data .rel.data.* .rel.gnu.linkonce.d.* )) }
	".rela.data_*lib_a-memcpy.o" 	: { KEEP(*lib_a-memcpy.o(.rela.data .rela.data.* .rela.gnu.linkonce.d.* )) }
	".rel.tdata_*lib_a-memcpy.o" 	: { KEEP(*lib_a-memcpy.o(.rel.tdata .rel.tdata.* .rel.gnu.linkonce.td.* )) }
	".rela.tdata_*lib_a-memcpy.o" 	: { KEEP(*lib_a-memcpy.o(.rela.tdata .rela.tdata.* .rela.gnu.linkonce.td.* )) }
	".rel.tbss_*lib_a-memcpy.o" 	: { KEEP(*lib_a-memcpy.o(.rel.tbss .rel.tbss.* .rel.gnu.linkonce.tb.* )) }
	".rela.tbss_*lib_a-memcpy.o" 	: { KEEP(*lib_a-memcpy.o(.rela.tbss .rela.tbss.* .rela.gnu.linkonce.tb.* )) }
	".rel.ctors_*lib_a-memcpy.o" 	: { KEEP(*lib_a-memcpy.o(.rel.ctors )) }
	".rela.ctors_*lib_a-memcpy.o" 	: { KEEP(*lib_a-memcpy.o(.rela.ctors )) }
	".rel.dtors_*lib_a-memcpy.o" 	: { KEEP(*lib_a-memcpy.o(.rel.dtors )) }
	".rela.dtors_*lib_a-memcpy.o" 	: { KEEP(*lib_a-memcpy.o(.rela.dtors )) }
	".rela.dyn_*lib_a-memcpy.o" 	: { KEEP(*lib_a-memcpy.o(rela.dyn )) KEEP(*lib_a-memcpy.o(.rela__libc_subfreeres )) KEEP(*lib_a-memcpy.o(.rela__libc_atexit )) KEEP(*lib_a-memcpy.o(.rela__libc_thread_subfreeres )) KEEP(*lib_a-memcpy.o(.rela.init_array )) KEEP(*lib_a-memcpy.o(.rela.fini_array )) }
	".rel.got_*lib_a-memcpy.o" 	: { KEEP(*lib_a-memcpy.o(.rel.got )) }
	".rela.got_*lib_a-memcpy.o" 	: { KEEP(*lib_a-memcpy.o(.rela.got )) }
	".rel.sdata_*lib_a-memcpy.o" 	: { KEEP(*lib_a-memcpy.o(.rel.sdata .rel.sdata.* .rel.gnu.linkonce.s.* )) }
	".rela.sdata_*lib_a-memcpy.o" 	: { KEEP(*lib_a-memcpy.o(.rela.sdata .rela.sdata.* .rela.gnu.linkonce.s.* )) }
	".rel.sbss_*lib_a-memcpy.o" 	: { KEEP(*lib_a-memcpy.o(.rel.sbss .rel.sbss.* .rel.gnu.linkonce.sb.* )) }
	".rela.sbss_*lib_a-memcpy.o" 	: { KEEP(*lib_a-memcpy.o(.rela.sbss .rela.sbss.* .rela.gnu.linkonce.sb.* )) }
	".rel.sdata2_*lib_a-memcpy.o" 	: { KEEP(*lib_a-memcpy.o(.rel.sdata2 .rel.sdata2.* .rel.gnu.linkonce.s2.* )) }
	".rela.sdata2_*lib_a-memcpy.o" 	: { KEEP(*lib_a-memcpy.o(.rela.sdata2 .rela.sdata2.* .rela.gnu.linkonce.s2.* )) }
	".rel.sbss2_*lib_a-memcpy.o" 	: { KEEP(*lib_a-memcpy.o(.rel.sbss2 .rel.sbss2.* .rel.gnu.linkonce.sb2.* )) }
	".rela.sbss2_*lib_a-memcpy.o" 	: { KEEP(*lib_a-memcpy.o(.rela.sbss2 .rela.sbss2.* .rela.gnu.linkonce.sb2.* )) }
	".rel.bss_*lib_a-memcpy.o" 	: { KEEP(*lib_a-memcpy.o(.rel.bss .rel.bss.* .rel.gnu.linkonce.b.* )) }
	".rela.bss_*lib_a-memcpy.o" 	: { KEEP(*lib_a-memcpy.o(.rela.bss .rela.bss.* .rela.gnu.linkonce.b.* )) }
	".rel.plt_*lib_a-memcpy.o" 	: { KEEP(*lib_a-memcpy.o(.rel.plt )) }
	".rela.plt_*lib_a-memcpy.o" 	: { KEEP(*lib_a-memcpy.o(.rela.plt )) }
	".init_*lib_a-memcpy.o" 	: { KEEP(*lib_a-memcpy.o(.init )) }
	".plt_*lib_a-memcpy.o" 	: { KEEP(*lib_a-memcpy.o(.plt )) }
	".text_*lib_a-memcpy.o" 	: { KEEP(*lib_a-memcpy.o(.text .stub .text.* .gnu.linkonce.t.* )) KEEP(*lib_a-memcpy.o(.text.*personality* )) KEEP(*lib_a-memcpy.o(.gnu.warning )) . = ALIGN(4); }
	".fini_*lib_a-memcpy.o" 	: { KEEP(*lib_a-memcpy.o(.fini )) }
	".ex9.itable_*lib_a-memcpy.o" 	: { KEEP(*lib_a-memcpy.o(.ex9.itable )) }
	PROVIDE (__etext = .);
	PROVIDE (_etext = .);
	PROVIDE (etext = .);
	".rodata_*lib_a-memcpy.o" 	: { KEEP(*lib_a-memcpy.o(.rodata .rodata.* .gnu.linkonce.r.* )) }
	".rodata1_*lib_a-memcpy.o" 	: { KEEP(*lib_a-memcpy.o(.rodata1 )) }
	".sdata2_*lib_a-memcpy.o" 	: { KEEP(*lib_a-memcpy.o(.sdata2 .sdata2.* .gnu.linkonce.s2.* )) }
	".sbss2_*lib_a-memcpy.o" 	: { KEEP(*lib_a-memcpy.o(.sbss2 .sbss2.* .gnu.linkonce.sb2.* )) }
	".eh_frame_hdr_*lib_a-memcpy.o" 	: { KEEP(*lib_a-memcpy.o(.eh_frame_hdr )) }
	".nds32_init_*lib_a-memset.o" 	: { KEEP(*lib_a-memset.o(.nds32_init )) }
	".interp_*lib_a-memset.o" 	: { KEEP(*lib_a-memset.o(.interp )) }
	".hash_*lib_a-memset.o" 	: { KEEP(*lib_a-memset.o(.hash )) }
	".dynsym_*lib_a-memset.o" 	: { KEEP(*lib_a-memset.o(.dynsym )) }
	".dynstr_*lib_a-memset.o" 	: { KEEP(*lib_a-memset.o(.dynstr )) }
	".gnu.version_*lib_a-memset.o" 	: { KEEP(*lib_a-memset.o(.gnu.version )) }
	".gnu.version_d_*lib_a-memset.o" 	: { KEEP(*lib_a-memset.o(.gnu.version_d )) }
	".gnu.version_r_*lib_a-memset.o" 	: { KEEP(*lib_a-memset.o(.gnu.version_r )) }
	".rel.init_*lib_a-memset.o" 	: { KEEP(*lib_a-memset.o(.rel.init )) }
	".rela.init_*lib_a-memset.o" 	: { KEEP(*lib_a-memset.o(.rela.init )) }
	".rel.text_*lib_a-memset.o" 	: { KEEP(*lib_a-memset.o(.rel.text .rel.text.* .rel.gnu.linkonce.t.* )) }
	".rela.text_*lib_a-memset.o" 	: { KEEP(*lib_a-memset.o(.rela.text .rela.text.* .rela.gnu.linkonce.t.* )) }
	".rel.fini_*lib_a-memset.o" 	: { KEEP(*lib_a-memset.o(.rel.fini )) }
	".rela.fini_*lib_a-memset.o" 	: { KEEP(*lib_a-memset.o(.rela.fini )) }
	".rel.rodata_*lib_a-memset.o" 	: { KEEP(*lib_a-memset.o(.rel.rodata .rel.rodata.* .rel.gnu.linkonce.r.* )) }
	".rela.rodata_*lib_a-memset.o" 	: { KEEP(*lib_a-memset.o(.rela.rodata .rela.rodata.* .rela.gnu.linkonce.r.* )) }
	".rel.data.rel.ro_*lib_a-memset.o" 	: { KEEP(*lib_a-memset.o(.rel.data.rel.ro* )) }
	".rela.data.rel.ro_*lib_a-memset.o" 	: { KEEP(*lib_a-memset.o(.rel.data.rel.ro* )) }
	".rel.data_*lib_a-memset.o" 	: { KEEP(*lib_a-memset.o(.rel.data .rel.data.* .rel.gnu.linkonce.d.* )) }
	".rela.data_*lib_a-memset.o" 	: { KEEP(*lib_a-memset.o(.rela.data .rela.data.* .rela.gnu.linkonce.d.* )) }
	".rel.tdata_*lib_a-memset.o" 	: { KEEP(*lib_a-memset.o(.rel.tdata .rel.tdata.* .rel.gnu.linkonce.td.* )) }
	".rela.tdata_*lib_a-memset.o" 	: { KEEP(*lib_a-memset.o(.rela.tdata .rela.tdata.* .rela.gnu.linkonce.td.* )) }
	".rel.tbss_*lib_a-memset.o" 	: { KEEP(*lib_a-memset.o(.rel.tbss .rel.tbss.* .rel.gnu.linkonce.tb.* )) }
	".rela.tbss_*lib_a-memset.o" 	: { KEEP(*lib_a-memset.o(.rela.tbss .rela.tbss.* .rela.gnu.linkonce.tb.* )) }
	".rel.ctors_*lib_a-memset.o" 	: { KEEP(*lib_a-memset.o(.rel.ctors )) }
	".rela.ctors_*lib_a-memset.o" 	: { KEEP(*lib_a-memset.o(.rela.ctors )) }
	".rel.dtors_*lib_a-memset.o" 	: { KEEP(*lib_a-memset.o(.rel.dtors )) }
	".rela.dtors_*lib_a-memset.o" 	: { KEEP(*lib_a-memset.o(.rela.dtors )) }
	".rela.dyn_*lib_a-memset.o" 	: { KEEP(*lib_a-memset.o(rela.dyn )) KEEP(*lib_a-memset.o(.rela__libc_subfreeres )) KEEP(*lib_a-memset.o(.rela__libc_atexit )) KEEP(*lib_a-memset.o(.rela__libc_thread_subfreeres )) KEEP(*lib_a-memset.o(.rela.init_array )) KEEP(*lib_a-memset.o(.rela.fini_array )) }
	".rel.got_*lib_a-memset.o" 	: { KEEP(*lib_a-memset.o(.rel.got )) }
	".rela.got_*lib_a-memset.o" 	: { KEEP(*lib_a-memset.o(.rela.got )) }
	".rel.sdata_*lib_a-memset.o" 	: { KEEP(*lib_a-memset.o(.rel.sdata .rel.sdata.* .rel.gnu.linkonce.s.* )) }
	".rela.sdata_*lib_a-memset.o" 	: { KEEP(*lib_a-memset.o(.rela.sdata .rela.sdata.* .rela.gnu.linkonce.s.* )) }
	".rel.sbss_*lib_a-memset.o" 	: { KEEP(*lib_a-memset.o(.rel.sbss .rel.sbss.* .rel.gnu.linkonce.sb.* )) }
	".rela.sbss_*lib_a-memset.o" 	: { KEEP(*lib_a-memset.o(.rela.sbss .rela.sbss.* .rela.gnu.linkonce.sb.* )) }
	".rel.sdata2_*lib_a-memset.o" 	: { KEEP(*lib_a-memset.o(.rel.sdata2 .rel.sdata2.* .rel.gnu.linkonce.s2.* )) }
	".rela.sdata2_*lib_a-memset.o" 	: { KEEP(*lib_a-memset.o(.rela.sdata2 .rela.sdata2.* .rela.gnu.linkonce.s2.* )) }
	".rel.sbss2_*lib_a-memset.o" 	: { KEEP(*lib_a-memset.o(.rel.sbss2 .rel.sbss2.* .rel.gnu.linkonce.sb2.* )) }
	".rela.sbss2_*lib_a-memset.o" 	: { KEEP(*lib_a-memset.o(.rela.sbss2 .rela.sbss2.* .rela.gnu.linkonce.sb2.* )) }
	".rel.bss_*lib_a-memset.o" 	: { KEEP(*lib_a-memset.o(.rel.bss .rel.bss.* .rel.gnu.linkonce.b.* )) }
	".rela.bss_*lib_a-memset.o" 	: { KEEP(*lib_a-memset.o(.rela.bss .rela.bss.* .rela.gnu.linkonce.b.* )) }
	".rel.plt_*lib_a-memset.o" 	: { KEEP(*lib_a-memset.o(.rel.plt )) }
	".rela.plt_*lib_a-memset.o" 	: { KEEP(*lib_a-memset.o(.rela.plt )) }
	".init_*lib_a-memset.o" 	: { KEEP(*lib_a-memset.o(.init )) }
	".plt_*lib_a-memset.o" 	: { KEEP(*lib_a-memset.o(.plt )) }
	".text_*lib_a-memset.o" 	: { KEEP(*lib_a-memset.o(.text .stub .text.* .gnu.linkonce.t.* )) KEEP(*lib_a-memset.o(.text.*personality* )) KEEP(*lib_a-memset.o(.gnu.warning )) . = ALIGN(4); }
	".fini_*lib_a-memset.o" 	: { KEEP(*lib_a-memset.o(.fini )) }
	".ex9.itable_*lib_a-memset.o" 	: { KEEP(*lib_a-memset.o(.ex9.itable )) }
	PROVIDE (__etext = .);
	PROVIDE (_etext = .);
	PROVIDE (etext = .);
	".rodata_*lib_a-memset.o" 	: { KEEP(*lib_a-memset.o(.rodata .rodata.* .gnu.linkonce.r.* )) }
	".rodata1_*lib_a-memset.o" 	: { KEEP(*lib_a-memset.o(.rodata1 )) }
	".sdata2_*lib_a-memset.o" 	: { KEEP(*lib_a-memset.o(.sdata2 .sdata2.* .gnu.linkonce.s2.* )) }
	".sbss2_*lib_a-memset.o" 	: { KEEP(*lib_a-memset.o(.sbss2 .sbss2.* .gnu.linkonce.sb2.* )) }
	".eh_frame_hdr_*lib_a-memset.o" 	: { KEEP(*lib_a-memset.o(.eh_frame_hdr )) }
	".nds32_init_*lib_a-memcmp.o" 	: { KEEP(*lib_a-memcmp.o(.nds32_init )) }
	".interp_*lib_a-memcmp.o" 	: { KEEP(*lib_a-memcmp.o(.interp )) }
	".hash_*lib_a-memcmp.o" 	: { KEEP(*lib_a-memcmp.o(.hash )) }
	".dynsym_*lib_a-memcmp.o" 	: { KEEP(*lib_a-memcmp.o(.dynsym )) }
	".dynstr_*lib_a-memcmp.o" 	: { KEEP(*lib_a-memcmp.o(.dynstr )) }
	".gnu.version_*lib_a-memcmp.o" 	: { KEEP(*lib_a-memcmp.o(.gnu.version )) }
	".gnu.version_d_*lib_a-memcmp.o" 	: { KEEP(*lib_a-memcmp.o(.gnu.version_d )) }
	".gnu.version_r_*lib_a-memcmp.o" 	: { KEEP(*lib_a-memcmp.o(.gnu.version_r )) }
	".rel.init_*lib_a-memcmp.o" 	: { KEEP(*lib_a-memcmp.o(.rel.init )) }
	".rela.init_*lib_a-memcmp.o" 	: { KEEP(*lib_a-memcmp.o(.rela.init )) }
	".rel.text_*lib_a-memcmp.o" 	: { KEEP(*lib_a-memcmp.o(.rel.text .rel.text.* .rel.gnu.linkonce.t.* )) }
	".rela.text_*lib_a-memcmp.o" 	: { KEEP(*lib_a-memcmp.o(.rela.text .rela.text.* .rela.gnu.linkonce.t.* )) }
	".rel.fini_*lib_a-memcmp.o" 	: { KEEP(*lib_a-memcmp.o(.rel.fini )) }
	".rela.fini_*lib_a-memcmp.o" 	: { KEEP(*lib_a-memcmp.o(.rela.fini )) }
	".rel.rodata_*lib_a-memcmp.o" 	: { KEEP(*lib_a-memcmp.o(.rel.rodata .rel.rodata.* .rel.gnu.linkonce.r.* )) }
	".rela.rodata_*lib_a-memcmp.o" 	: { KEEP(*lib_a-memcmp.o(.rela.rodata .rela.rodata.* .rela.gnu.linkonce.r.* )) }
	".rel.data.rel.ro_*lib_a-memcmp.o" 	: { KEEP(*lib_a-memcmp.o(.rel.data.rel.ro* )) }
	".rela.data.rel.ro_*lib_a-memcmp.o" 	: { KEEP(*lib_a-memcmp.o(.rel.data.rel.ro* )) }
	".rel.data_*lib_a-memcmp.o" 	: { KEEP(*lib_a-memcmp.o(.rel.data .rel.data.* .rel.gnu.linkonce.d.* )) }
	".rela.data_*lib_a-memcmp.o" 	: { KEEP(*lib_a-memcmp.o(.rela.data .rela.data.* .rela.gnu.linkonce.d.* )) }
	".rel.tdata_*lib_a-memcmp.o" 	: { KEEP(*lib_a-memcmp.o(.rel.tdata .rel.tdata.* .rel.gnu.linkonce.td.* )) }
	".rela.tdata_*lib_a-memcmp.o" 	: { KEEP(*lib_a-memcmp.o(.rela.tdata .rela.tdata.* .rela.gnu.linkonce.td.* )) }
	".rel.tbss_*lib_a-memcmp.o" 	: { KEEP(*lib_a-memcmp.o(.rel.tbss .rel.tbss.* .rel.gnu.linkonce.tb.* )) }
	".rela.tbss_*lib_a-memcmp.o" 	: { KEEP(*lib_a-memcmp.o(.rela.tbss .rela.tbss.* .rela.gnu.linkonce.tb.* )) }
	".rel.ctors_*lib_a-memcmp.o" 	: { KEEP(*lib_a-memcmp.o(.rel.ctors )) }
	".rela.ctors_*lib_a-memcmp.o" 	: { KEEP(*lib_a-memcmp.o(.rela.ctors )) }
	".rel.dtors_*lib_a-memcmp.o" 	: { KEEP(*lib_a-memcmp.o(.rel.dtors )) }
	".rela.dtors_*lib_a-memcmp.o" 	: { KEEP(*lib_a-memcmp.o(.rela.dtors )) }
	".rela.dyn_*lib_a-memcmp.o" 	: { KEEP(*lib_a-memcmp.o(rela.dyn )) KEEP(*lib_a-memcmp.o(.rela__libc_subfreeres )) KEEP(*lib_a-memcmp.o(.rela__libc_atexit )) KEEP(*lib_a-memcmp.o(.rela__libc_thread_subfreeres )) KEEP(*lib_a-memcmp.o(.rela.init_array )) KEEP(*lib_a-memcmp.o(.rela.fini_array )) }
	".rel.got_*lib_a-memcmp.o" 	: { KEEP(*lib_a-memcmp.o(.rel.got )) }
	".rela.got_*lib_a-memcmp.o" 	: { KEEP(*lib_a-memcmp.o(.rela.got )) }
	".rel.sdata_*lib_a-memcmp.o" 	: { KEEP(*lib_a-memcmp.o(.rel.sdata .rel.sdata.* .rel.gnu.linkonce.s.* )) }
	".rela.sdata_*lib_a-memcmp.o" 	: { KEEP(*lib_a-memcmp.o(.rela.sdata .rela.sdata.* .rela.gnu.linkonce.s.* )) }
	".rel.sbss_*lib_a-memcmp.o" 	: { KEEP(*lib_a-memcmp.o(.rel.sbss .rel.sbss.* .rel.gnu.linkonce.sb.* )) }
	".rela.sbss_*lib_a-memcmp.o" 	: { KEEP(*lib_a-memcmp.o(.rela.sbss .rela.sbss.* .rela.gnu.linkonce.sb.* )) }
	".rel.sdata2_*lib_a-memcmp.o" 	: { KEEP(*lib_a-memcmp.o(.rel.sdata2 .rel.sdata2.* .rel.gnu.linkonce.s2.* )) }
	".rela.sdata2_*lib_a-memcmp.o" 	: { KEEP(*lib_a-memcmp.o(.rela.sdata2 .rela.sdata2.* .rela.gnu.linkonce.s2.* )) }
	".rel.sbss2_*lib_a-memcmp.o" 	: { KEEP(*lib_a-memcmp.o(.rel.sbss2 .rel.sbss2.* .rel.gnu.linkonce.sb2.* )) }
	".rela.sbss2_*lib_a-memcmp.o" 	: { KEEP(*lib_a-memcmp.o(.rela.sbss2 .rela.sbss2.* .rela.gnu.linkonce.sb2.* )) }
	".rel.bss_*lib_a-memcmp.o" 	: { KEEP(*lib_a-memcmp.o(.rel.bss .rel.bss.* .rel.gnu.linkonce.b.* )) }
	".rela.bss_*lib_a-memcmp.o" 	: { KEEP(*lib_a-memcmp.o(.rela.bss .rela.bss.* .rela.gnu.linkonce.b.* )) }
	".rel.plt_*lib_a-memcmp.o" 	: { KEEP(*lib_a-memcmp.o(.rel.plt )) }
	".rela.plt_*lib_a-memcmp.o" 	: { KEEP(*lib_a-memcmp.o(.rela.plt )) }
	".init_*lib_a-memcmp.o" 	: { KEEP(*lib_a-memcmp.o(.init )) }
	".plt_*lib_a-memcmp.o" 	: { KEEP(*lib_a-memcmp.o(.plt )) }
	".text_*lib_a-memcmp.o" 	: { KEEP(*lib_a-memcmp.o(.text .stub .text.* .gnu.linkonce.t.* )) KEEP(*lib_a-memcmp.o(.text.*personality* )) KEEP(*lib_a-memcmp.o(.gnu.warning )) . = ALIGN(4); }
	".fini_*lib_a-memcmp.o" 	: { KEEP(*lib_a-memcmp.o(.fini )) }
	".ex9.itable_*lib_a-memcmp.o" 	: { KEEP(*lib_a-memcmp.o(.ex9.itable )) }
	PROVIDE (__etext = .);
	PROVIDE (_etext = .);
	PROVIDE (etext = .);
	".rodata_*lib_a-memcmp.o" 	: { KEEP(*lib_a-memcmp.o(.rodata .rodata.* .gnu.linkonce.r.* )) }
	".rodata1_*lib_a-memcmp.o" 	: { KEEP(*lib_a-memcmp.o(.rodata1 )) }
	".sdata2_*lib_a-memcmp.o" 	: { KEEP(*lib_a-memcmp.o(.sdata2 .sdata2.* .gnu.linkonce.s2.* )) }
	".sbss2_*lib_a-memcmp.o" 	: { KEEP(*lib_a-memcmp.o(.sbss2 .sbss2.* .gnu.linkonce.sb2.* )) }
	".eh_frame_hdr_*lib_a-memcmp.o" 	: { KEEP(*lib_a-memcmp.o(.eh_frame_hdr )) }
	".nds32_init_*lib_a-memmove.o" 	: { KEEP(*lib_a-memmove.o(.nds32_init )) }
	".interp_*lib_a-memmove.o" 	: { KEEP(*lib_a-memmove.o(.interp )) }
	".hash_*lib_a-memmove.o" 	: { KEEP(*lib_a-memmove.o(.hash )) }
	".dynsym_*lib_a-memmove.o" 	: { KEEP(*lib_a-memmove.o(.dynsym )) }
	".dynstr_*lib_a-memmove.o" 	: { KEEP(*lib_a-memmove.o(.dynstr )) }
	".gnu.version_*lib_a-memmove.o" 	: { KEEP(*lib_a-memmove.o(.gnu.version )) }
	".gnu.version_d_*lib_a-memmove.o" 	: { KEEP(*lib_a-memmove.o(.gnu.version_d )) }
	".gnu.version_r_*lib_a-memmove.o" 	: { KEEP(*lib_a-memmove.o(.gnu.version_r )) }
	".rel.init_*lib_a-memmove.o" 	: { KEEP(*lib_a-memmove.o(.rel.init )) }
	".rela.init_*lib_a-memmove.o" 	: { KEEP(*lib_a-memmove.o(.rela.init )) }
	".rel.text_*lib_a-memmove.o" 	: { KEEP(*lib_a-memmove.o(.rel.text .rel.text.* .rel.gnu.linkonce.t.* )) }
	".rela.text_*lib_a-memmove.o" 	: { KEEP(*lib_a-memmove.o(.rela.text .rela.text.* .rela.gnu.linkonce.t.* )) }
	".rel.fini_*lib_a-memmove.o" 	: { KEEP(*lib_a-memmove.o(.rel.fini )) }
	".rela.fini_*lib_a-memmove.o" 	: { KEEP(*lib_a-memmove.o(.rela.fini )) }
	".rel.rodata_*lib_a-memmove.o" 	: { KEEP(*lib_a-memmove.o(.rel.rodata .rel.rodata.* .rel.gnu.linkonce.r.* )) }
	".rela.rodata_*lib_a-memmove.o" 	: { KEEP(*lib_a-memmove.o(.rela.rodata .rela.rodata.* .rela.gnu.linkonce.r.* )) }
	".rel.data.rel.ro_*lib_a-memmove.o" 	: { KEEP(*lib_a-memmove.o(.rel.data.rel.ro* )) }
	".rela.data.rel.ro_*lib_a-memmove.o" 	: { KEEP(*lib_a-memmove.o(.rel.data.rel.ro* )) }
	".rel.data_*lib_a-memmove.o" 	: { KEEP(*lib_a-memmove.o(.rel.data .rel.data.* .rel.gnu.linkonce.d.* )) }
	".rela.data_*lib_a-memmove.o" 	: { KEEP(*lib_a-memmove.o(.rela.data .rela.data.* .rela.gnu.linkonce.d.* )) }
	".rel.tdata_*lib_a-memmove.o" 	: { KEEP(*lib_a-memmove.o(.rel.tdata .rel.tdata.* .rel.gnu.linkonce.td.* )) }
	".rela.tdata_*lib_a-memmove.o" 	: { KEEP(*lib_a-memmove.o(.rela.tdata .rela.tdata.* .rela.gnu.linkonce.td.* )) }
	".rel.tbss_*lib_a-memmove.o" 	: { KEEP(*lib_a-memmove.o(.rel.tbss .rel.tbss.* .rel.gnu.linkonce.tb.* )) }
	".rela.tbss_*lib_a-memmove.o" 	: { KEEP(*lib_a-memmove.o(.rela.tbss .rela.tbss.* .rela.gnu.linkonce.tb.* )) }
	".rel.ctors_*lib_a-memmove.o" 	: { KEEP(*lib_a-memmove.o(.rel.ctors )) }
	".rela.ctors_*lib_a-memmove.o" 	: { KEEP(*lib_a-memmove.o(.rela.ctors )) }
	".rel.dtors_*lib_a-memmove.o" 	: { KEEP(*lib_a-memmove.o(.rel.dtors )) }
	".rela.dtors_*lib_a-memmove.o" 	: { KEEP(*lib_a-memmove.o(.rela.dtors )) }
	".rela.dyn_*lib_a-memmove.o" 	: { KEEP(*lib_a-memmove.o(rela.dyn )) KEEP(*lib_a-memmove.o(.rela__libc_subfreeres )) KEEP(*lib_a-memmove.o(.rela__libc_atexit )) KEEP(*lib_a-memmove.o(.rela__libc_thread_subfreeres )) KEEP(*lib_a-memmove.o(.rela.init_array )) KEEP(*lib_a-memmove.o(.rela.fini_array )) }
	".rel.got_*lib_a-memmove.o" 	: { KEEP(*lib_a-memmove.o(.rel.got )) }
	".rela.got_*lib_a-memmove.o" 	: { KEEP(*lib_a-memmove.o(.rela.got )) }
	".rel.sdata_*lib_a-memmove.o" 	: { KEEP(*lib_a-memmove.o(.rel.sdata .rel.sdata.* .rel.gnu.linkonce.s.* )) }
	".rela.sdata_*lib_a-memmove.o" 	: { KEEP(*lib_a-memmove.o(.rela.sdata .rela.sdata.* .rela.gnu.linkonce.s.* )) }
	".rel.sbss_*lib_a-memmove.o" 	: { KEEP(*lib_a-memmove.o(.rel.sbss .rel.sbss.* .rel.gnu.linkonce.sb.* )) }
	".rela.sbss_*lib_a-memmove.o" 	: { KEEP(*lib_a-memmove.o(.rela.sbss .rela.sbss.* .rela.gnu.linkonce.sb.* )) }
	".rel.sdata2_*lib_a-memmove.o" 	: { KEEP(*lib_a-memmove.o(.rel.sdata2 .rel.sdata2.* .rel.gnu.linkonce.s2.* )) }
	".rela.sdata2_*lib_a-memmove.o" 	: { KEEP(*lib_a-memmove.o(.rela.sdata2 .rela.sdata2.* .rela.gnu.linkonce.s2.* )) }
	".rel.sbss2_*lib_a-memmove.o" 	: { KEEP(*lib_a-memmove.o(.rel.sbss2 .rel.sbss2.* .rel.gnu.linkonce.sb2.* )) }
	".rela.sbss2_*lib_a-memmove.o" 	: { KEEP(*lib_a-memmove.o(.rela.sbss2 .rela.sbss2.* .rela.gnu.linkonce.sb2.* )) }
	".rel.bss_*lib_a-memmove.o" 	: { KEEP(*lib_a-memmove.o(.rel.bss .rel.bss.* .rel.gnu.linkonce.b.* )) }
	".rela.bss_*lib_a-memmove.o" 	: { KEEP(*lib_a-memmove.o(.rela.bss .rela.bss.* .rela.gnu.linkonce.b.* )) }
	".rel.plt_*lib_a-memmove.o" 	: { KEEP(*lib_a-memmove.o(.rel.plt )) }
	".rela.plt_*lib_a-memmove.o" 	: { KEEP(*lib_a-memmove.o(.rela.plt )) }
	".init_*lib_a-memmove.o" 	: { KEEP(*lib_a-memmove.o(.init )) }
	".plt_*lib_a-memmove.o" 	: { KEEP(*lib_a-memmove.o(.plt )) }
	".text_*lib_a-memmove.o" 	: { KEEP(*lib_a-memmove.o(.text .stub .text.* .gnu.linkonce.t.* )) KEEP(*lib_a-memmove.o(.text.*personality* )) KEEP(*lib_a-memmove.o(.gnu.warning )) . = ALIGN(4); }
	".fini_*lib_a-memmove.o" 	: { KEEP(*lib_a-memmove.o(.fini )) }
	".ex9.itable_*lib_a-memmove.o" 	: { KEEP(*lib_a-memmove.o(.ex9.itable )) }
	PROVIDE (__etext = .);
	PROVIDE (_etext = .);
	PROVIDE (etext = .);
	".rodata_*lib_a-memmove.o" 	: { KEEP(*lib_a-memmove.o(.rodata .rodata.* .gnu.linkonce.r.* )) }
	".rodata1_*lib_a-memmove.o" 	: { KEEP(*lib_a-memmove.o(.rodata1 )) }
	".sdata2_*lib_a-memmove.o" 	: { KEEP(*lib_a-memmove.o(.sdata2 .sdata2.* .gnu.linkonce.s2.* )) }
	".sbss2_*lib_a-memmove.o" 	: { KEEP(*lib_a-memmove.o(.sbss2 .sbss2.* .gnu.linkonce.sb2.* )) }
	".eh_frame_hdr_*lib_a-memmove.o" 	: { KEEP(*lib_a-memmove.o(.eh_frame_hdr )) }
	.ilm_rtos_section 	: { KEEP(*(.ilm_rtos_section )) }
	.dcdriver.isr 	: { KEEP(*(.dcdriver.isr )) }
	.nds32_vector 	: { KEEP(*(.nds32_vector )) KEEP(*(SORT(.nds32_vector.* ))) }
	.nds32_nmih 	: { *(.nds32_nmih ) }
	.nds32_wrh 	: { *(.nds32_wrh ) }
	.nds32_jmptbl 	: { KEEP(*(.nds32_jmptbl )) KEEP(*(SORT(.nds32_jmptbl.* ))) }
	.nds32_isr 	: { *(.nds32_isr ) }
	.nds32_init 	: { KEEP(*(.nds32_init )) }
	.interp 	: { *(.interp ) }
	.hash 	: { *(.hash ) }
	.dynsym 	: { *(.dynsym ) }
	.dynstr 	: { *(.dynstr ) }
	.gnu.version 	: { *(.gnu.version ) }
	.gnu.version_d 	: { *(.gnu.version_d ) }
	.gnu.version_r 	: { *(.gnu.version_r ) }
	.rel.init 	: { *(.rel.init ) }
	.rela.init 	: { *(.rela.init ) }
	.rel.text 	: { *(.rel.text .rel.text.* .rel.gnu.linkonce.t.* ) }
	.rela.text 	: { *(.rela.text .rela.text.* .rela.gnu.linkonce.t.* ) }
	.rel.fini 	: { *(.rel.fini ) }
	.rela.fini 	: { *(.rela.fini ) }
	.rel.rodata 	: { *(.rel.rodata .rel.rodata.* .rel.gnu.linkonce.r.* ) }
	.rela.rodata 	: { *(.rela.rodata .rela.rodata.* .rela.gnu.linkonce.r.* ) }
	.rel.data.rel.ro 	: { *(.rel.data.rel.ro* ) }
	.rela.data.rel.ro 	: { *(.rel.data.rel.ro* ) }
	.rel.data 	: { *(.rel.data .rel.data.* .rel.gnu.linkonce.d.* ) }
	.rela.data 	: { *(.rela.data .rela.data.* .rela.gnu.linkonce.d.* ) }
	.rel.tdata 	: { *(.rel.tdata .rel.tdata.* .rel.gnu.linkonce.td.* ) }
	.rela.tdata 	: { *(.rela.tdata .rela.tdata.* .rela.gnu.linkonce.td.* ) }
	.rel.tbss 	: { *(.rel.tbss .rel.tbss.* .rel.gnu.linkonce.tb.* ) }
	.rela.tbss 	: { *(.rela.tbss .rela.tbss.* .rela.gnu.linkonce.tb.* ) }
	.rel.ctors 	: { *(.rel.ctors ) }
	.rela.ctors 	: { *(.rela.ctors ) }
	.rel.dtors 	: { *(.rel.dtors ) }
	.rela.dtors 	: { *(.rela.dtors ) }
	.rela.dyn 	: { *(rela.dyn ) *(.rela__libc_subfreeres ) *(.rela__libc_atexit ) *(.rela__libc_thread_subfreeres ) *(.rela.init_array ) *(.rela.fini_array ) }
	.rel.got 	: { *(.rel.got ) }
	.rela.got 	: { *(.rela.got ) }
	.rel.sdata 	: { *(.rel.sdata .rel.sdata.* .rel.gnu.linkonce.s.* ) }
	.rela.sdata 	: { *(.rela.sdata .rela.sdata.* .rela.gnu.linkonce.s.* ) }
	.rel.sbss 	: { *(.rel.sbss .rel.sbss.* .rel.gnu.linkonce.sb.* ) }
	.rela.sbss 	: { *(.rela.sbss .rela.sbss.* .rela.gnu.linkonce.sb.* ) }
	.rel.sdata2 	: { *(.rel.sdata2 .rel.sdata2.* .rel.gnu.linkonce.s2.* ) }
	.rela.sdata2 	: { *(.rela.sdata2 .rela.sdata2.* .rela.gnu.linkonce.s2.* ) }
	.rel.sbss2 	: { *(.rel.sbss2 .rel.sbss2.* .rel.gnu.linkonce.sb2.* ) }
	.rela.sbss2 	: { *(.rela.sbss2 .rela.sbss2.* .rela.gnu.linkonce.sb2.* ) }
	.rel.bss 	: { *(.rel.bss .rel.bss.* .rel.gnu.linkonce.b.* ) }
	.rela.bss 	: { *(.rela.bss .rela.bss.* .rela.gnu.linkonce.b.* ) }
	.rel.plt 	: { *(.rel.plt ) }
	.rela.plt 	: { *(.rela.plt ) }
	.init 	: { KEEP(*(.init )) }
	.plt 	: { *(.plt ) }
	.text 	: { *(.text .stub .text.* .gnu.linkonce.t.* ) KEEP(*(.text.*personality* )) *(.gnu.warning ) . = ALIGN(4); }
	.fini 	: { KEEP(*(.fini )) }
	.ex9.itable 	: { *(.ex9.itable ) }
	PROVIDE (__etext = .);
	PROVIDE (_etext = .);
	PROVIDE (etext = .);
	.rodata 	: { *(.rodata .rodata.* .gnu.linkonce.r.* ) }
	.rodata1 	: { *(.rodata1 ) }
	.sdata2 	: { *(.sdata2 .sdata2.* .gnu.linkonce.s2.* ) }
	.sbss2 	: { *(.sbss2 .sbss2.* .gnu.linkonce.sb2.* ) }
	.eh_frame_hdr 	: { *(.eh_frame_hdr ) }
	. = 0x2000E000;
	_SDA_BASE_ = 0x20040000;
	PROVIDE (_stack = 0x2000E000);
	. = ALIGN(0x20);
	__data_lmastart =  LOADADDR (.eh_frame);
	__data_start = ADDR(.eh_frame);
	.eh_frame 	: AT(ALIGN(LOADADDR (.eh_frame_hdr) + SIZEOF (.eh_frame_hdr), 32))
		{ KEEP(*(.eh_frame )) }
	.gcc_except_table 	: AT(ALIGN(LOADADDR (.eh_frame) + SIZEOF (.eh_frame), ALIGNOF(.gcc_except_table)))
		{ KEEP(*(.gcc_except_table )) *(.gcc_except_table.* ) }
	.tdata 	: AT(ALIGN(LOADADDR (.gcc_except_table) + SIZEOF (.gcc_except_table), ALIGNOF(.tdata)))
		{ *(.tdata .tdata.* .gnu.linkonce.td.* ) }
	. = ALIGN(4);
	PROVIDE (__preinit_array_start = .);
	.preinit_array 	: AT(ALIGN(ALIGN(LOADADDR (.tdata) + SIZEOF (.tdata), ALIGNOF(.preinit_array)), 4))
		{ KEEP(*(.preinit_array )) }
	PROVIDE (__preinit_array_end = .);
	PROVIDE (__init_array_start = .);
	.init_array 	: AT(ALIGN(LOADADDR (.preinit_array) + SIZEOF (.preinit_array), ALIGNOF(.init_array)))
		{ KEEP(*(.init_array )) }
	PROVIDE (__init_array_end = .);
	PROVIDE (__fini_array_start = .);
	.fini_array 	: AT(ALIGN(LOADADDR (.init_array) + SIZEOF (.init_array), ALIGNOF(.fini_array)))
		{ KEEP(*(.fini_array )) }
	PROVIDE (__fini_array_end = .);
	.ctors 	: AT(ALIGN(LOADADDR (.fini_array) + SIZEOF (.fini_array), ALIGNOF(.ctors)))
		{ KEEP(*crtbegin*.o(.ctors)) KEEP(*(EXCLUDE_FILE (*crtend*.o) .ctors)) KEEP(*(SORT(.ctors.* ))) KEEP(*(.ctors )) }
	.dtors 	: AT(ALIGN(LOADADDR (.ctors) + SIZEOF (.ctors), ALIGNOF(.dtors)))
		{ KEEP(*crtbegin*.o(.dtors)) KEEP(*(EXCLUDE_FILE (*crtend*.o) .dtors)) KEEP(*(SORT(.dtors.* ))) KEEP(*(.dtors )) }
	.jcr 	: AT(ALIGN(LOADADDR (.dtors) + SIZEOF (.dtors), ALIGNOF(.jcr)))
		{ KEEP(*(.jcr )) }
	.data.rel.ro 	: AT(ALIGN(LOADADDR (.jcr) + SIZEOF (.jcr), ALIGNOF(.data.rel.ro)))
		{ *(.data.rel.ro.local ) *(.data.rel.ro* ) }
	.dynamic 	: AT(ALIGN(LOADADDR (.data.rel.ro) + SIZEOF (.data.rel.ro), ALIGNOF(.dynamic)))
		{ *(.dynamic ) }
	.data 	: AT(ALIGN(LOADADDR (.dynamic) + SIZEOF (.dynamic), ALIGNOF(.data)))
		{ *(.data .data.* .gnu.linkonce.d.* ) KEEP(*(.gnu.linkonce.d.*personality* )) SORT(CONSTRUCTORS) . = ALIGN(8); }
	.data1 	: AT(ALIGN(LOADADDR (.data) + SIZEOF (.data), ALIGNOF(.data1)))
		{ *(.data1 ) . = ALIGN(8); }
	. = ALIGN(4);
	.got 	: AT(ALIGN(ALIGN(LOADADDR (.data1) + SIZEOF (.data1), ALIGNOF(.got)), 4))
		{ *(.got.plt ) *(.got ) }
	.sdata_d 	: AT(ALIGN(LOADADDR (.got) + SIZEOF (.got), ALIGNOF(.sdata_d)))
		{ *(.sdata_d .sdata_d.* ) }
	.sdata_w 	: AT(ALIGN(LOADADDR (.sdata_d) + SIZEOF (.sdata_d), ALIGNOF(.sdata_w)))
		{ *(.sdata_w .sdata_w.* ) }
	.sdata_h 	: AT(ALIGN(LOADADDR (.sdata_w) + SIZEOF (.sdata_w), ALIGNOF(.sdata_h)))
		{ *(.sdata_h .sdata_h.* ) }
	.sdata_b 	: AT(ALIGN(LOADADDR (.sdata_h) + SIZEOF (.sdata_h), ALIGNOF(.sdata_b)))
		{ *(.sdata_b .sdata_b.* ) }
	.sdata_f 	: AT(ALIGN(LOADADDR (.sdata_b) + SIZEOF (.sdata_b), ALIGNOF(.sdata_f)))
		{ *(.sdata_f .sdata_f.* ) }
	. = ALIGN(4);
	_edata = .;
	PROVIDE (edata = .);
	__bss_start = .;
	PROVIDE (__sbss_start = .);
	PROVIDE (___sbss_start = .);
	.tbss 	: AT(ALIGN(ALIGN(LOADADDR (.sdata_f) + SIZEOF (.sdata_f), ALIGNOF(.tbss)), 4))
		{ *(.tbss .tbss.* .gnu.linkonce.tb.* ) *(.tcommon ) }
	.sbss_f 	: AT(ALIGN(LOADADDR (.tbss) + SIZEOF (.tbss), ALIGNOF(.sbss_f)))
		{ *(.sbss_f .sbss_f.* ) *(.scommon_f .scommon_f.* ) }
	.sbss_b 	: AT(ALIGN(LOADADDR (.sbss_f) + SIZEOF (.sbss_f), ALIGNOF(.sbss_b)))
		{ *(.sbss_b .sbss_b.* ) *(.scommon_b .scommon_b.* ) . = ALIGN(2); }
	.sbss_h 	: AT(ALIGN(LOADADDR (.sbss_b) + SIZEOF (.sbss_b), ALIGNOF(.sbss_h)))
		{ *(.sbss_h .sbss_h.* ) *(.scommon_h .scommon_h.* ) . = ALIGN(4); }
	.sbss_w 	: AT(ALIGN(LOADADDR (.sbss_h) + SIZEOF (.sbss_h), ALIGNOF(.sbss_w)))
		{ *(.sbss_w .sbss_w.* ) *(.scommon_w .scommon_w.* ) *(.dynsbss ) *(.scommon ) . = ALIGN(8); }
	.sbss_d 	: AT(ALIGN(LOADADDR (.sbss_w) + SIZEOF (.sbss_w), ALIGNOF(.sbss_d)))
		{ *(.sbss_d .sbss_d.* ) *(.scommon_d .scommon_d.* ) }
	.bss 	: AT(ALIGN(LOADADDR (.sbss_d) + SIZEOF (.sbss_d), ALIGNOF(.bss)))
		{ *(.dynbss ) *(.bss .bss.* .gnu.linkonce.b.* ) *(COMMON ) . = ALIGN(4); }
	PROVIDE (__sbss_end = .);
	PROVIDE (___sbss_end = .);
	. = ALIGN(4);
	_end = .;
	PROVIDE (end = .);
	EILM_SIZE = LOADADDR(.sdata_f) + SIZEOF(.sdata_f) - EILM_BEGIN;
	.stab	0 : { *(.stab) }
	.stabstr	0 : { *(.stabstr) }
	.stab.excl	0 : { *(.stab.excl) }
	.stab.exclstr	0 : { *(.stab.exclstr) }
	.stab.index	0 : { *(.stab.index) }
	.stab.indexstr	0 : { *(.stab.indexstr) }
	.note.nds32	0 : { *(.note.nds32) *(.note.nds32.*) }
	.comment	0 : { *(.comment) }
	.debug	0 : { *(.debug) }
	.line	0 : { *(.line) }
	.debug_srcinfo	0 : { *(.debug_srcinfo) }
	.debug_sfnames	0 : { *(.debug_sfnames) }
	.debug_aranges	0 : { *(.debug_aranges) }
	.debug_pubnames	0 : { *(.debug_pubnames) }
	.debug_info	0 : { *(.debug_info .gnu.linkonce.wi.*) }
	.debug_abbrev	0 : { *(.debug_abbrev) }
	.debug_line	0 : { *(.debug_line) }
	.debug_frame	0 : { *(.debug_frame) }
	.debug_str	0 : { *(.debug_str) }
	.debug_loc	0 : { *(.debug_loc) }
	.debug_macinfo	0 : { *(.debug_macinfo) }
	.debug_weaknames	0 : { *(.debug_weaknames) }
	.debug_funcnames	0 : { *(.debug_funcnames) }
	.debug_typenames	0 : { *(.debug_typenames) }
	.debug_varnames	0 : { *(.debug_varnames) }
}
ASSERT((DEFINED (_RELAX_END_) ? EILM_SIZE : 0x0)<= 0x00900000, "EILM OVERFLOW");
